/dts-v1/;

/ {
	/* board name first: the Seekwave driver builds its firmware filenames from it.
	 * rk3528a last, because rkmpp has no rk3518 entry and cannot otherwise find the VPU */
	compatible = "h96max-zx,rk3518-tvbox", "rockchip,rk3518-evb1-ddr4-v10", "rockchip,rk3518", "rockchip,rk3528a";
	interrupt-parent = <&gic>;
	#address-cells = <0x02>;
	#size-cells = <0x02>;
	model = "H96 Max 3518_ZX_V01 (Rockchip RK3518 EVB1 DDR4 V10 Board)";

	aliases {
		ethernet0 = "/ethernet@ffbd0000";
		gpio0 = "/pinctrl/gpio@ff610000";
		gpio1 = "/pinctrl/gpio@ffaf0000";
		gpio2 = "/pinctrl/gpio@ffb00000";
		gpio3 = "/pinctrl/gpio@ffb10000";
		gpio4 = "/pinctrl/gpio@ffb20000";
		i2c0 = "/i2c@ffa50000";
		i2c1 = "/i2c@ffa58000";
		i2c2 = "/i2c@ffa60000";
		i2c3 = "/i2c@ffa68000";
		i2c4 = "/i2c@ffa70000";
		i2c5 = "/i2c@ffa78000";
		i2c6 = "/i2c@ffa80000";
		i2c7 = "/i2c@ffa88000";
		serial0 = "/serial@ff9f0000";
		serial1 = "/serial@ff9f8000";
		serial2 = "/serial@ffa00000";
		serial3 = "/serial@ffa08000";
		serial4 = "/serial@ffa10000";
		serial5 = "/serial@ffa18000";
		serial6 = "/serial@ffa20000";
		serial7 = "/serial@ffa28000";
		spi0 = "/spi@ff9c0000";
		spi1 = "/spi@ff9d0000";
		spi2 = "/spi@ffc00000";
	};

	clocks {
		compatible = "simple-bus";
		#address-cells = <0x02>;
		#size-cells = <0x02>;
		ranges;

		xin24m: xin24m {
			compatible = "fixed-clock";
			#clock-cells = <0x00>;
			clock-frequency = <0x16e3600>;
			clock-output-names = "xin24m";
			phandle = <0x85>;
		};

		mclkin_sai0: mclkin-sai0 {
			compatible = "fixed-clock";
			#clock-cells = <0x00>;
			clock-frequency = <0x00>;
			clock-output-names = "i2s0_mclkin";
			phandle = <0xac>;
		};

		mclkin_sai1: mclkin-sai1 {
			compatible = "fixed-clock";
			#clock-cells = <0x00>;
			clock-frequency = <0x00>;
			clock-output-names = "i2s1_mclkin";
			phandle = <0xad>;
		};

		mclkout_sai0: mclkout-sai0@ff340014 {
			compatible = "rockchip,clk-out";
			reg = <0x00 0xff340014 0x00 0x04>;
			clocks = <&cru 0xaf>;
			#clock-cells = <0x00>;
			clock-output-names = "mclk_sai0_to_io";
			rockchip,bit-shift = <0x01>;
			rockchip,bit-set-to-disable;
			phandle = <0xae>;
		};

		mclkout_sai1: mclkout-sai1@ff320004 {
			compatible = "rockchip,clk-out";
			reg = <0x00 0xff320004 0x00 0x04>;
			clocks = <&cru 0x123>;
			#clock-cells = <0x00>;
			clock-output-names = "mclk_sai1_to_io";
			rockchip,bit-shift = <0x0e>;
			rockchip,bit-set-to-disable;
			phandle = <0xaf>;
		};
	};

	cpus {
		#address-cells = <0x02>;
		#size-cells = <0x00>;

		cpu-map {

			cluster0 {

				core0 {
					cpu = <&cpu0>;
				};

				core1 {
					cpu = <&cpu1>;
				};

				core2 {
					cpu = <&cpu2>;
				};

				core3 {
					cpu = <&cpu3>;
				};
			};
		};

		cpu0: cpu@0 {
			device_type = "cpu";
			compatible = "arm,cortex-a53";
			reg = <0x00 0x00>;
			enable-method = "psci";
			clocks = <&scmi_clk 0x15>;
			#cooling-cells = <0x02>;
			dynamic-power-coefficient = <0x93>;
			operating-points-v2 = <&cpu0_opp_table>;
			cpu-idle-states = <&CPU_SLEEP0>;
			cpu-supply = <&vdd_cpu>;
			phandle = <0x03>;
		};

		cpu1: cpu@1 {
			device_type = "cpu";
			compatible = "arm,cortex-a53";
			reg = <0x00 0x01>;
			enable-method = "psci";
			clocks = <&scmi_clk 0x15>;
			operating-points-v2 = <&cpu0_opp_table>;
			cpu-idle-states = <&CPU_SLEEP0>;
			phandle = <0x04>;
		};

		cpu2: cpu@2 {
			device_type = "cpu";
			compatible = "arm,cortex-a53";
			reg = <0x00 0x02>;
			enable-method = "psci";
			clocks = <&scmi_clk 0x15>;
			operating-points-v2 = <&cpu0_opp_table>;
			cpu-idle-states = <&CPU_SLEEP1>;
			phandle = <0x05>;
		};

		cpu3: cpu@3 {
			device_type = "cpu";
			compatible = "arm,cortex-a53";
			reg = <0x00 0x03>;
			enable-method = "psci";
			clocks = <&scmi_clk 0x15>;
			operating-points-v2 = <&cpu0_opp_table>;
			cpu-idle-states = <&CPU_SLEEP1>;
			phandle = <0x06>;
		};

		idle-states {
			entry-method = "psci";

			CPU_SLEEP0: cpu-sleep0 {
				compatible = "arm,idle-state";
				local-timer-stop;
				arm,psci-suspend-param = <0x10000>;
				entry-latency-us = <0x78>;
				exit-latency-us = <0xfa>;
				min-residency-us = <0x384>;
				status = "disabled";
				phandle = <0x09>;
			};

			CPU_SLEEP1: cpu-sleep {
				compatible = "arm,idle-state";
				local-timer-stop;
				arm,psci-suspend-param = <0x10000>;
				entry-latency-us = <0x78>;
				exit-latency-us = <0xfa>;
				min-residency-us = <0x384>;
				status = "okay";
				phandle = <0x0b>;
			};
		};
	};

	cpu0_opp_table: cpu0-opp-table {
		compatible = "operating-points-v2";
		opp-shared;
		mbist-vmin = <0xc96a8 0xe1d48 0xe1d48>;
		nvmem-cells = <&cpu_leakage &cpu_opp_info &cpu_mbist_vmin>;
		nvmem-cell-names = "leakage", "opp-info", "mbist-vmin";
		rockchip,video-4k-freq = <0x124f80>;
		rockchip,pvtm-voltage-sel = <0x00 0x58c 0x00 0x582 0x5a4 0x01 0x5a5 0x5c2 0x02 0x5c3 0x5e5 0x03 0x5e6 0x608 0x04 0x609 0x62b 0x05 0x62c 0x653 0x06 0x654 0x699 0x07 0x69a 0x6d0 0x08 0x6d1 0x707 0x09 0x708 0x270f 0x0a>;
		rockchip,pvtm-pvtpll;
		rockchip,pvtm-offset = <0x18>;
		rockchip,pvtm-sample-time = <0x44c>;
		rockchip,pvtm-freq = <0x159b40>;
		rockchip,pvtm-volt = <0xe7ef0>;
		rockchip,pvtm-ref-temp = <0x28>;
		rockchip,pvtm-temp-prop = <0x00 0x00>;
		rockchip,pvtm-thermal-zone = "soc-thermal";
		rockchip,grf = <&grf>;
		rockchip,temp-hysteresis = <0x1388>;
		rockchip,low-temp = <0x2710>;
		rockchip,low-temp-min-volt = <0xdbba0>;
		rockchip,video-1080p-freq = <0x124f80>;
		phandle = <0x08>;

		opp-1200000000 {
			opp-hz = <0x00 0x47868c00>;
			opp-microvolt = <0xdbba0 0xdbba0 0xf4240>;
			clock-latency-ns = <0x9c40>;
		};

		opp-1416000000 {
			opp-hz = <0x00 0x54667200>;
			opp-microvolt = <0xdbba0 0xdbba0 0xf4240>;
			opp-microvolt-L1 = <0xe7ef0 0xe7ef0 0xf4240>;
			opp-microvolt-L2 = <0xe4e1c 0xe4e1c 0xf4240>;
			opp-microvolt-L3 = <0xe1d48 0xe1d48 0xf4240>;
			opp-microvolt-L4 = <0xdec74 0xdec74 0xf4240>;
			clock-latency-ns = <0x9c40>;
			opp-microvolt-L0 = <0xeafc4 0xeafc4 0xf4240>;
		};
	};

	arm-pmu {
		compatible = "arm,cortex-a53-pmu";
		interrupts = <0x00 0xab 0x04 0x00 0xac 0x04 0x00 0xad 0x04 0x00 0xae 0x04>;
		interrupt-affinity = <&cpu0 &cpu1 &cpu2 &cpu3>;
	};

	cpuinfo {
		compatible = "rockchip,cpuinfo";
		nvmem-cells = <&otp_id &otp_cpu_version &cpu_code &cpu_code1>;
		nvmem-cell-names = "id", "cpu-version", "cpu-code", "cpu-code1";
	};

	display_subsystem: display-subsystem {
		compatible = "rockchip,display-subsystem";
		ports = <&vop_out>;
		status = "okay";
		memory-region = <&drm_logo &drm_cubic_lut>;
		memory-region-names = "drm-logo", "drm-cubic-lut";
		phandle = <0xb0>;

		route {

			route_hdmi: route-hdmi {
				status = "okay";
				logo,uboot = "logo.bmp";
				logo,mode = "fullscreen";
				charge_logo,mode = "center";
				connect = <&vp0_out_hdmi>;
				phandle = <0xb1>;
			};

			route_tve: route-tve {
				status = "okay";
				logo,uboot = "logo.bmp";
				logo,mode = "fullscreen";
				charge_logo,mode = "center";
				connect = <&vp1_out_tve>;
				phandle = <0xb2>;
			};
		};
	};

	dmc: dmc {
		compatible = "rockchip,rk3528-dmc";
		interrupts = <0x00 0x11 0x04>;
		interrupt-names = "complete";
		devfreq-events = <&dfi>;
		clocks = <&scmi_clk 0x14>;
		clock-names = "dmc_clk";
		operating-points-v2 = <&dmc_opp_table>;
		upthreshold = <0x28>;
		downdifferential = <0x14>;
		system-status-level = <0x01 0x08>;
		auto-min-freq = <0x4f1a0>;
		auto-freq-en = <0x00>;
		status = "okay";
		center-supply = <&vdd_cpu>;
		phandle = <0xb3>;
	};

	dmc_opp_table: dmc-opp-table {
		compatible = "operating-points-v2";
		mbist-vmin = <0xcf850 0xdbba0>;
		nvmem-cells = <&log_leakage &dmc_opp_info &logic_mbist_vmin>;
		nvmem-cell-names = "leakage", "opp-info", "mbist-vmin";
		rockchip,temp-hysteresis = <0x1388>;
		rockchip,low-temp = <0x2710>;
		rockchip,low-temp-min-volt = <0xdbba0>;
		rockchip,leakage-voltage-sel = <0x01 0x0a 0x00 0x0b 0x0e 0x01 0x0f 0x16 0x02 0x17 0x1c 0x03 0x1d 0xfe 0x04>;
		phandle = <0x1a>;

		opp-324000000 {
			opp-hz = <0x00 0x134fd900>;
			opp-microvolt = <0xdbba0 0xdbba0 0xf4240>;
		};

		opp-666000000 {
			opp-hz = <0x00 0x27b25a80>;
			opp-microvolt = <0xdbba0 0xdbba0 0xf4240>;
		};

		opp-1056000000 {
			opp-hz = <0x00 0x3ef14800>;
			opp-microvolt = <0xdbba0 0xdbba0 0xf4240>;
		};

		opp-1184000000 {
			opp-hz = <0x00 0x46926800>;
			opp-microvolt = <0xdbba0 0xdbba0 0xf4240>;
			opp-microvolt-L0 = <0xe7ef0 0xe7ef0 0xf4240>;
			opp-microvolt-L1 = <0xe1d48 0xe1d48 0xf4240>;
			opp-microvolt-L2 = <0xdbba0 0xdbba0 0xf4240>;
			opp-microvolt-L3 = <0xd59f8 0xd59f8 0xf4240>;
			opp-microvolt-L4 = <0xd2924 0xd2924 0xf4240>;
			status = "disabled";
		};

		opp-780000000 {
			opp-hz = <0x00 0x2e7ddb00>;
			opp-microvolt = <0xdbba0 0xdbba0 0xf4240>;
		};
	};

	firmware {

		scmi: scmi {
			compatible = "arm,scmi-smc";
			shmem = <&scmi_shmem>;
			arm,smc-id = <0x82000010>;
			#address-cells = <0x01>;
			#size-cells = <0x00>;
			phandle = <0xb4>;

			scmi_clk: protocol@14 {
				reg = <0x14>;
				#clock-cells = <0x01>;
				assigned-clocks = <&scmi_clk 0x15>;
				assigned-clock-rates = <0x47868c00>;
				phandle = <0x07>;
			};
		};

		optee {
			compatible = "linaro,optee-tz";
			method = "smc";
		};
	};

	mpp_srv: mpp-srv {
		compatible = "rockchip,mpp-service";
		rockchip,taskqueue-count = <0x05>;
		rockchip,resetgroup-count = <0x05>;
		rockchip,iommu-shared-mask = <0x420a>;
		status = "okay";
		phandle = <0x2f>;
	};

	psci {
		compatible = "arm,psci-1.0";
		method = "smc";
	};

	rkvtunnel: rkvtunnel {
		compatible = "rockchip,video-tunnel";
		status = "okay";
		phandle = <0xb5>;
	};

	rockchip_suspend: rockchip-suspend {
		compatible = "rockchip,pm-rk3528";
		status = "okay";
		rockchip,sleep-debug-en = <0x01>;
		rockchip,sleep-mode-config = <0x01>;
		rockchip,wakeup-config = <0x11>;
		rockchip,virtual-poweroff = <0x01>;
		rockchip,pwm-regulator-config = <0x03>;
		phandle = <0xb6>;
	};

	rockchip_system_monitor: rockchip-system-monitor {
		compatible = "rockchip,system-monitor";
		rockchip,thermal-zone = "soc-thermal";
		rockchip,polling-delay = <0xc8>;
		rockchip,temp-hysteresis = <0x1388>;
		rockchip,offline-cpu-temp = <0x19a28>;
		rockchip,temp-offline-cpus = "2-3";
		phandle = <0xb7>;
	};

	secure_otp: secure-otp {
		compatible = "rockchip,secure-otp";
		rockchip,otp-size = <0x20>;
		status = "disabled";
		phandle = <0xb8>;
	};

	thermal_zones: thermal-zones {
		phandle = <0xb9>;

		soc_thermal: soc-thermal {
			polling-delay-passive = <0x14>;
			polling-delay = <0x3e8>;
			sustainable-power = <0x27e>;
			thermal-sensors = <&tsadc 0x00>;
			phandle = <0xba>;

			trips {

				threshold: trip-point-0 {
					temperature = <0x17318>;
					hysteresis = <0x7d0>;
					type = "passive";
					phandle = <0xbb>;
				};

				target: trip-point-1 {
					temperature = <0x1adb0>;
					hysteresis = <0x7d0>;
					type = "passive";
					phandle = <0x20>;
				};

				soc_crit: soc-crit {
					temperature = <0x1d4c0>;
					hysteresis = <0x7d0>;
					type = "critical";
					phandle = <0xbc>;
				};
			};

			cooling-maps {

				map0 {
					trip = <0x20>;
					cooling-device = <&cpu0 0xffffffff 0xffffffff>;
					contribution = <0x400>;
				};

				map1 {
					trip = <0x20>;
					cooling-device = <&gpu 0xffffffff 0xffffffff>;
					contribution = <0x400>;
				};
			};
		};
	};

	timer {
		compatible = "arm,armv8-timer";
		interrupts = <0x01 0x0d 0xf08 0x01 0x0e 0xf08 0x01 0x0b 0xf08 0x01 0x0a 0xf08>;
	};

	scmi_shmem: scmi-shmem@10f000 {
		compatible = "arm,scmi-shmem";
		reg = <0x00 0x10f000 0x00 0x100>;
		phandle = <0x1e>;
	};

	sram: sram@fe480000 {
		compatible = "mmio-sram";
		reg = <0x00 0xfe480000 0x00 0xc000>;
		#address-cells = <0x01>;
		#size-cells = <0x01>;
		ranges = <0x00 0x00 0xfe480000 0xc000>;
		phandle = <0xbd>;

		rkvdec_sram: rkvdec-sram@0 {
			reg = <0x00 0xc000>;
			phandle = <0x30>;
		};
	};

	usbdrd30: usbdrd {
		compatible = "rockchip,rk3528-dwc3", "rockchip,rk3399-dwc3";
		clocks = <&cru 0x106 &cru 0x107 &cru 0x105>;
		clock-names = "ref_clk", "suspend_clk", "bus_clk";
		#address-cells = <0x02>;
		#size-cells = <0x02>;
		ranges;
		status = "okay";
		phandle = <0xbe>;

		usbdrd_dwc3: dwc3@fe500000 {
			compatible = "snps,dwc3";
			reg = <0x00 0xfe500000 0x00 0x400000>;
			interrupts = <0x00 0x98 0x04>;
			dr_mode = "host";
			phys = <&u2phy_otg &combphy_pu 0x04>;
			phy-names = "usb2-phy", "usb3-phy";
			phy_type = "utmi_wide";
			resets = <&cru 0x211>;
			reset-names = "usb3-otg";
			snps,dis_enblslpm_quirk;
			snps,dis-u1-entry-quirk;
			snps,dis-u2-entry-quirk;
			snps,dis-u2-freeclk-exists-quirk;
			snps,dis-del-phy-power-chg-quirk;
			snps,dis-tx-ipgap-linecheck-quirk;
			snps,dis_rxdet_inp3_quirk;
			snps,parkmode-disable-hs-quirk;
			snps,parkmode-disable-ss-quirk;
			quirk-skip-phy-init;
			status = "okay";
			extcon = <&usb2phy>;
			phandle = <0xbf>;
		};
	};

	gic: interrupt-controller@fed01000 {
		compatible = "arm,gic-400";
		#interrupt-cells = <0x03>;
		#address-cells = <0x00>;
		interrupt-controller;
		reg = <0x00 0xfed01000 0x00 0x1000 0x00 0xfed02000 0x00 0x2000 0x00 0xfed04000 0x00 0x2000 0x00 0xfed06000 0x00 0x2000>;
		interrupts = <0x01 0x09 0xf08>;
		phandle = <0x01>;
	};

	usb_host0_ehci: usb@ff100000 {
		compatible = "generic-ehci";
		reg = <0x00 0xff100000 0x00 0x40000>;
		interrupts = <0x00 0x8f 0x04>;
		clocks = <&cru 0x1a0 &cru 0x1a1 &usb2phy>;
		clock-names = "usbhost", "arbiter", "utmi";
		phys = <&u2phy_host>;
		phy-names = "usb2-phy";
		status = "okay";
		phandle = <0xc0>;
	};

	usb_host0_ohci: usb@ff140000 {
		compatible = "generic-ohci";
		reg = <0x00 0xff140000 0x00 0x40000>;
		interrupts = <0x00 0x90 0x04>;
		clocks = <&cru 0x1a0 &cru 0x1a1 &usb2phy>;
		clock-names = "usbhost", "arbiter", "utmi";
		phys = <&u2phy_host>;
		phy-names = "usb2-phy";
		status = "okay";
		phandle = <0xc1>;
	};

	debug: debug@ff190000 {
		compatible = "rockchip,debug";
		reg = <0x00 0xff190000 0x00 0x1000 0x00 0xff192000 0x00 0x1000 0x00 0xff194000 0x00 0x1000 0x00 0xff196000 0x00 0x1000>;
		phandle = <0xc2>;
	};

	qos_crypto_a: qos@ff200000 {
		compatible = "syscon";
		reg = <0x00 0xff200000 0x00 0x20>;
		phandle = <0xc3>;
	};

	qos_crypto_p: qos@ff200080 {
		compatible = "syscon";
		reg = <0x00 0xff200080 0x00 0x20>;
		phandle = <0xc4>;
	};

	qos_dcf: qos@ff200100 {
		compatible = "syscon";
		reg = <0x00 0xff200100 0x00 0x20>;
		phandle = <0xc5>;
	};

	qos_dft2apb: qos@ff200200 {
		compatible = "syscon";
		reg = <0x00 0xff200200 0x00 0x20>;
		phandle = <0xc6>;
	};

	qos_dma2ddr: qos@ff200280 {
		compatible = "syscon";
		reg = <0x00 0xff200280 0x00 0x20>;
		phandle = <0xc7>;
	};

	qos_dmac: qos@ff200300 {
		compatible = "syscon";
		reg = <0x00 0xff200300 0x00 0x20>;
		phandle = <0xc8>;
	};

	qos_keyreader: qos@ff200380 {
		compatible = "syscon";
		reg = <0x00 0xff200380 0x00 0x20>;
		phandle = <0xc9>;
	};

	qos_cpu: qos@ff210000 {
		compatible = "syscon";
		reg = <0x00 0xff210000 0x00 0x20>;
		phandle = <0xca>;
	};

	qos_debug: qos@ff210080 {
		compatible = "syscon";
		reg = <0x00 0xff210080 0x00 0x20>;
		phandle = <0xcb>;
	};

	qos_gpu_m0: qos@ff220000 {
		compatible = "syscon";
		reg = <0x00 0xff220000 0x00 0x20>;
		phandle = <0x26>;
	};

	qos_gpu_m1: qos@ff220080 {
		compatible = "syscon";
		reg = <0x00 0xff220080 0x00 0x20>;
		phandle = <0x27>;
	};

	qos_pmu_mcu: qos@ff240000 {
		compatible = "syscon";
		reg = <0x00 0xff240000 0x00 0x20>;
		phandle = <0xcc>;
	};

	qos_rkvdec: qos@ff250000 {
		compatible = "syscon";
		reg = <0x00 0xff250000 0x00 0x20>;
		phandle = <0xcd>;
	};

	qos_rkvenc: qos@ff260000 {
		compatible = "syscon";
		reg = <0x00 0xff260000 0x00 0x20>;
		phandle = <0xce>;
	};

	qos_gmac0: qos@ff270000 {
		compatible = "syscon";
		reg = <0x00 0xff270000 0x00 0x20>;
		phandle = <0xcf>;
	};

	qos_hdcp: qos@ff270080 {
		compatible = "syscon";
		reg = <0x00 0xff270080 0x00 0x20>;
		phandle = <0xd0>;
	};

	qos_jpegdec: qos@ff270100 {
		compatible = "syscon";
		reg = <0x00 0xff270100 0x00 0x20>;
		phandle = <0xd1>;
	};

	qos_rga2_m0ro: qos@ff270200 {
		compatible = "syscon";
		reg = <0x00 0xff270200 0x00 0x20>;
		phandle = <0xd2>;
	};

	qos_rga2_m0wo: qos@ff270280 {
		compatible = "syscon";
		reg = <0x00 0xff270280 0x00 0x20>;
		phandle = <0xd3>;
	};

	qos_sdmmc0: qos@ff270300 {
		compatible = "syscon";
		reg = <0x00 0xff270300 0x00 0x20>;
		phandle = <0xd4>;
	};

	qos_usb2host: qos@ff270380 {
		compatible = "syscon";
		reg = <0x00 0xff270380 0x00 0x20>;
		phandle = <0xd5>;
	};

	qos_vdpp: qos@ff270480 {
		compatible = "syscon";
		reg = <0x00 0xff270480 0x00 0x20>;
		phandle = <0xd6>;
	};

	qos_vop: qos@ff270500 {
		compatible = "syscon";
		reg = <0x00 0xff270500 0x00 0x20>;
		phandle = <0xd7>;
	};

	qos_emmc: qos@ff280000 {
		compatible = "syscon";
		reg = <0x00 0xff280000 0x00 0x20>;
		phandle = <0xd8>;
	};

	qos_fspi: qos@ff280080 {
		compatible = "syscon";
		reg = <0x00 0xff280080 0x00 0x20>;
		phandle = <0xd9>;
	};

	qos_gmac1: qos@ff280100 {
		compatible = "syscon";
		reg = <0x00 0xff280100 0x00 0x20>;
		phandle = <0xda>;
	};

	qos_pcie: qos@ff280180 {
		compatible = "syscon";
		reg = <0x00 0xff280180 0x00 0x20>;
		phandle = <0xdb>;
	};

	qos_sdio0: qos@ff280200 {
		compatible = "syscon";
		reg = <0x00 0xff280200 0x00 0x20>;
		phandle = <0xdc>;
	};

	qos_sdio1: qos@ff280280 {
		compatible = "syscon";
		reg = <0x00 0xff280280 0x00 0x20>;
		phandle = <0xdd>;
	};

	qos_tsp: qos@ff280300 {
		compatible = "syscon";
		reg = <0x00 0xff280300 0x00 0x20>;
		phandle = <0xde>;
	};

	qos_usb3otg: qos@ff280380 {
		compatible = "syscon";
		reg = <0x00 0xff280380 0x00 0x20>;
		phandle = <0xdf>;
	};

	qos_vpu: qos@ff280400 {
		compatible = "syscon";
		reg = <0x00 0xff280400 0x00 0x20>;
		phandle = <0xe0>;
	};

	grf: syscon@ff300000 {
		compatible = "rockchip,rk3528-grf", "syscon", "simple-mfd";
		reg = <0x00 0xff300000 0x00 0x90000>;
		phandle = <0x0f>;

		grf_cru: grf-clock-controller {
			compatible = "rockchip,rk3528-grf-cru";
			#clock-cells = <0x01>;
			phandle = <0x78>;
		};

		reboot_mode: reboot-mode {
			compatible = "syscon-reboot-mode";
			offset = <0x70200>;
			mode-bootloader = <0x5242c301>;
			mode-charge = <0x5242c30b>;
			mode-fastboot = <0x5242c309>;
			mode-loader = <0x5242c301>;
			mode-normal = <0x5242c300>;
			mode-recovery = <0x5242c303>;
			mode-ums = <0x5242c30c>;
			mode-panic = <0x5242c307>;
			mode-watchdog = <0x5242c308>;
			phandle = <0xe1>;
		};
	};

	cru: clock-controller@ff4a0000 {
		compatible = "rockchip,rk3528-cru";
		reg = <0x00 0xff4a0000 0x00 0x30000>;
		rockchip,grf = <&grf>;
		#clock-cells = <0x01>;
		#reset-cells = <0x01>;
		assigned-clocks = <&cru 0x1ff &cru 0x03 &cru 0x04 &cru 0x02 &cru 0x0d &cru 0x11 &cru 0x09 &cru 0x0a &cru 0x0b &cru 0x0c &cru 0x0e &cru 0x0f &cru 0x10 &cru 0x12 &cru 0x90 &cru 0x8f &cru 0x95 &cru 0x55 &cru 0x144 &cru 0x96 &cru 0x93>;
		assigned-clock-rates = <0x8000 0x46cf7100 0x3b9aca00 0x3b5dc100 0xee6b280 0x1dcd6500 0x2faf080 0x5f5e100 0x8f0d180 0xbebc200 0x11e1a300 0x1443fd00 0x17d78400 0x23c34600 0x2faf080 0x5f5e100 0x7735940 0x1dcd6500 0x1443fd00 0x11e1a300 0xbebc200>;
		phandle = <0x02>;
	};

	ioc_grf: syscon@ff540000 {
		compatible = "rockchip,rk3528-ioc-grf", "syscon";
		reg = <0x00 0xff540000 0x00 0x40000>;
		phandle = <0x86>;
	};

	pmu: power-management@ff600000 {
		compatible = "rockchip,rk3528-pmu", "syscon", "simple-mfd";
		reg = <0x00 0xff600000 0x00 0x2000>;
		phandle = <0xe2>;

		power: power-controller {
			compatible = "rockchip,rk3528-power-controller";
			#power-domain-cells = <0x01>;
			#address-cells = <0x01>;
			#size-cells = <0x00>;
			status = "okay";
			phandle = <0x28>;

			pd_gpu@4 {
				reg = <0x04>;
				clocks = <&cru 0x113 &cru 0x10e>;
				pm_qos = <&qos_gpu_m0 &qos_gpu_m1>;
			};

			pd_rkvdec@5 {
				reg = <0x05>;
			};

			pd_rkvenc@6 {
				reg = <0x06>;
			};

			pd_vo@7 {
				reg = <0x07>;
			};

			pd_vpu@8 {
				reg = <0x08>;
			};
		};
	};

	mailbox: mailbox@ff630000 {
		compatible = "rockchip,rk3528-mailbox", "rockchip,rk3368-mailbox";
		reg = <0x00 0xff630000 0x00 0x200>;
		interrupts = <0x00 0x3c 0x04>;
		clocks = <&cru 0x20a>;
		clock-names = "pclk_mailbox";
		#mbox-cells = <0x01>;
		status = "disabled";
		phandle = <0xe3>;
	};

	gpu: gpu@ff700000 {
		compatible = "arm,mali-450";
		reg = <0x00 0xff700000 0x00 0x40000>;
		interrupts = <0x00 0x58 0x04 0x00 0x59 0x04 0x00 0x56 0x04 0x00 0x5c 0x04 0x00 0x5d 0x04 0x00 0x5a 0x04 0x00 0x5b 0x04>;
		/* names mainline lima expects; the vendor Mali blob used its own */
		interrupt-names = "gp", "gpmmu", "pp", "pp0", "ppmmu0", "pp1", "ppmmu1";
		clocks = <&cru 0x113 &cru 0x113>;
		clock-names = "bus", "core";
		assigned-clocks = <&scmi_clk 0x16>;
		assigned-clock-rates = <0x11e1a300>;
		power-domains = <&power 0x04>;
		operating-points-v2 = <&gpu_opp_table>;
		#cooling-cells = <0x02>;
		rockchip,grf = <&grf>;
		status = "okay";
		mali-supply = <&vdd_cpu>;
		phandle = <0x21>;

		gpu_power_model: power-model {
			compatible = "simple-power-model";
			leakage-range = <0x01 0x03>;
			ls = <0xffffc2d6 0x1071a 0x00>;
			static-coefficient = <0x2710>;
			dynamic-coefficient = <0x2d4>;
			ts = <0x302a42 0x1d55a 0xfffff636 0x27>;
			thermal-zone = "soc-thermal";
			phandle = <0xe4>;
		};
	};

	gpu_opp_table: gpu-opp-table {
		compatible = "operating-points-v2";
		mbist-vmin = <0xc96a8 0xe1d48>;
		nvmem-cells = <&gpu_leakage &gpu_opp_info &gpu_mbist_vmin>;
		nvmem-cell-names = "leakage", "opp-info", "mbist-vmin";
		rockchip,pvtm-voltage-sel = <0x00 0x329 0x00 0x32a 0x33e 0x01 0x33f 0x352 0x02 0x353 0x370 0x03 0x371 0x37a 0x04 0x37b 0x38e 0x05 0x38f 0x3a2 0x06 0x3a3 0x3b6 0x07 0x3b7 0x3ca 0x08 0x3cb 0x3e3 0x09 0x3e8 0x270f 0x0a>;
		rockchip,pvtm-pvtpll;
		rockchip,pvtm-offset = <0x10018>;
		rockchip,pvtm-sample-time = <0x44c>;
		rockchip,pvtm-freq = "", "\f5";
		rockchip,pvtm-volt = <0xe7ef0>;
		rockchip,pvtm-ref-temp = <0x28>;
		rockchip,pvtm-temp-prop = <0x00 0x00>;
		rockchip,pvtm-thermal-zone = "soc-thermal";
		rockchip,grf = <&grf>;
		rockchip,temp-hysteresis = <0x1388>;
		rockchip,low-temp = <0x2710>;
		rockchip,low-temp-min-volt = <0xdbba0>;
		phandle = <0x29>;

		opp-700000000 {
			opp-hz = <0x00 0x29b92700>;
			opp-microvolt = <0xdbba0 0xdbba0 0xf4240>;
		};

		opp-800000000 {
			opp-hz = <0x00 0x2faf0800>;
			opp-microvolt = <0xdbba0 0xdbba0 0xf4240>;
			opp-microvolt-L1 = <0xe7ef0 0xe7ef0 0xf4240>;
			opp-microvolt-L2 = <0xe4e1c 0xe4e1c 0xf4240>;
			opp-microvolt-L3 = <0xe1d48 0xe1d48 0xf4240>;
			opp-microvolt-L4 = <0xdec74 0xdec74 0xf4240>;
			opp-microvolt-L5 = <0xdbba0 0xdbba0 0xf4240>;
			opp-microvolt-L0 = <0xeafc4 0xeafc4 0xf4240>;
		};
	};

	gpu_bus: gpu-bus {
		compatible = "rockchip,rk3528-bus";
		rockchip,busfreq-policy = "clkfreq";
		clocks = <&scmi_clk 0x16>;
		clock-names = "bus";
		operating-points-v2 = <&gpu_bus_opp_table>;
		status = "disabled";
		phandle = <0xe5>;
	};

	gpu_bus_opp_table: gpu-bus-opp-table {
		compatible = "operating-points-v2";
		nvmem-cells = <&log_leakage>;
		nvmem-cell-names = "leakage";
		rockchip,leakage-voltage-sel = <0x01 0x16 0x00 0x17 0xfe 0x01>;
		phandle = <0x2d>;

		opp-700000000 {
			opp-hz = <0x00 0x29b92700>;
			opp-microvolt = <0xcf850 0xcf850 0xf4240>;
		};

		opp-800000000 {
			opp-hz = <0x00 0x2faf0800>;
			opp-microvolt = <0xd59f8 0xd59f8 0xf4240>;
			opp-microvolt-L1 = <0xcf850 0xcf850 0xf4240>;
		};
	};

	rkvdec: rkvdec@ff740100 {
		compatible = "rockchip,rkv-decoder-rk3528", "rockchip,rkv-decoder-v2";
		reg = <0x00 0xff740100 0x00 0x400 0x00 0xff740000 0x00 0x100>;
		reg-names = "regs", "link";
		interrupts = <0x00 0x5e 0x04>;
		interrupt-names = "irq_dec";
		clocks = <&cru 0x1b7 &cru 0x1b8 &cru 0x1b9>;
		clock-names = "aclk_vcodec", "hclk_vcodec", "clk_hevc_cabac";
		rockchip,normal-rates = <0x1443fd00 0x00 0x23c34600>;
		assigned-clocks = <&cru 0x1b7 &cru 0x1b9>;
		assigned-clock-rates = <0x1443fd00 0x23c34600>;
		resets = <&cru 0x2c8 &cru 0x2c9 &cru 0x2cb>;
		reset-names = "video_a", "video_h", "video_hevc_cabac";
		iommus = <&rkvdec_mmu>;
		rockchip,srv = <&mpp_srv>;
		rockchip,taskqueue-node = <0x00>;
		rockchip,resetgroup-node = <0x00>;
		rockchip,task-capacity = <0x10>;
		rockchip,sram = <&rkvdec_sram>;
		rockchip,rcb-iova = <0x10000000 0x10000>;
		rockchip,rcb-min-width = <0x200>;
		status = "okay";
		phandle = <0xe6>;
	};

	rkvdec_mmu: iommu@ff740800 {
		compatible = "rockchip,iommu-v2";
		reg = <0x00 0xff740800 0x00 0x40 0x00 0xff740900 0x00 0x40>;
		interrupts = <0x00 0x5f 0x04>;
		interrupt-names = "rkvdec_mmu";
		clocks = <&cru 0x1b7 &cru 0x1b8 &cru 0x1b9>;
		clock-names = "aclk", "iface", "clk_hevc_cabac";
		#iommu-cells = <0x00>;
		rockchip,shootdown-entire;
		status = "okay";
		phandle = <0x2e>;
	};

	rkvenc: rkvenc@ff780000 {
		compatible = "rockchip,rkv-encoder-rk3528", "rockchip,rkv-encoder-v2";
		reg = <0x00 0xff780000 0x00 0x6000>;
		interrupts = <0x00 0x61 0x04>;
		interrupt-names = "irq_rkvenc";
		clocks = <&cru 0x120 &cru 0x11f &cru 0x121>;
		clock-names = "aclk_vcodec", "hclk_vcodec", "clk_core";
		rockchip,normal-rates = <0x11e1a300 0x00 0x11e1a300>;
		resets = <&cru 0x247 &cru 0x246 &cru 0x248>;
		reset-names = "video_a", "video_h", "video_core";
		assigned-clocks = <&cru 0x120 &cru 0x121>;
		assigned-clock-rates = <0x11e1a300 0x11e1a300>;
		iommus = <&rkvenc_mmu>;
		rockchip,srv = <&mpp_srv>;
		rockchip,grf = <&grf>;
		rockchip,grf-mem-offset = <0x20010>;
		rockchip,grf-mem-values = <0x21 0xffff0021>;
		rockchip,taskqueue-node = <&gic>;
		rockchip,resetgroup-node = <&gic>;
		status = "okay";
		phandle = <0xe7>;
	};

	rkvenc_mmu: iommu@ff78f000 {
		compatible = "rockchip,iommu-v2";
		reg = <0x00 0xff78f000 0x00 0x40>;
		interrupts = <0x00 0x60 0x04>;
		interrupt-names = "rkvenc_mmu";
		clocks = <&cru 0x120 &cru 0x11f>;
		clock-names = "aclk", "iface";
		#iommu-cells = <0x00>;
		rockchip,shootdown-entire;
		status = "okay";
		phandle = <0x31>;
	};

	vdpu: vdpu@ff7c0400 {
		compatible = "rockchip,vpu-decoder-v2";
		reg = <0x00 0xff7c0400 0x00 0x400>;
		interrupts = <0x00 0x62 0x04>;
		interrupt-names = "irq_dec";
		clocks = <&cru 0x9c &cru 0x9d>;
		clock-names = "aclk_vcodec", "hclk_vcodec";
		rockchip,normal-rates = <0x11e1a300 0x00>;
		assigned-clocks = <&cru 0x9c>;
		assigned-clock-rates = <0x11e1a300>;
		resets = <&cru 0x199 &cru 0x19a>;
		reset-names = "shared_video_a", "shared_video_h";
		iommus = <&vdpu_mmu>;
		rockchip,srv = <&mpp_srv>;
		rockchip,grf = <&grf>;
		rockchip,grf-mem-offset = <0x40034>;
		rockchip,grf-mem-values = <0xf040000 0xf040f04>;
		rockchip,taskqueue-node = <&cru>;
		rockchip,resetgroup-node = <&cru>;
		rockchip,disable-auto-freq;
		status = "okay";
		phandle = <0xe8>;
	};

	vdpu_mmu: iommu@ff7c0800 {
		compatible = "rockchip,iommu-v2";
		reg = <0x00 0xff7c0800 0x00 0x40>;
		interrupts = <0x00 0x63 0x04>;
		interrupt-names = "vdpu_mmu";
		clock-names = "aclk", "iface";
		clocks = <&cru 0x9c &cru 0x9d>;
		#iommu-cells = <0x00>;
		rockchip,shootdown-entire;
		status = "okay";
		phandle = <0x32>;
	};

	avsd: avsd_plus@ff7c1000 {
		compatible = "rockchip,avs-plus-decoder";
		reg = <0x00 0xff7c1000 0x00 0x200>;
		interrupts = <0x00 0x62 0x04>;
		interrupt-names = "irq_dec";
		clocks = <&cru 0x9c &cru 0x9d>;
		clock-names = "aclk_vcodec", "hclk_vcodec";
		rockchip,normal-rates = <0x11e1a300 0x00>;
		assigned-clocks = <&cru 0x9c>;
		assigned-clock-rates = <0x11e1a300>;
		resets = <&cru 0x199 &cru 0x19a>;
		reset-names = "shared_video_a", "shared_video_h";
		iommus = <&vdpu_mmu>;
		rockchip,srv = <&mpp_srv>;
		rockchip,taskqueue-node = <&cru>;
		rockchip,resetgroup-node = <&cru>;
		rockchip,disable-auto-freq;
		status = "okay";
		phandle = <0xe9>;
	};

	vop: vop@ff840000 {
		compatible = "rockchip,rk3528-vop";
		reg = <0x00 0xff840000 0x00 0x3000 0x00 0xff845000 0x00 0x1000 0x00 0xff846400 0x00 0x800>;
		reg-names = "regs", "gamma_lut", "acm_regs";
		interrupts = <0x00 0x6d 0x04>;
		clocks = <&cru 0x157 &cru 0x154 &cru 0x155 &cru 0x156>;
		clock-names = "aclk_vop", "hclk_vop", "dclk_vp0", "dclk_vp1";
		assigned-clocks = <&cru 0x155>;
		assigned-clock-parents = <&inno_hdmiphy_clk>;
		iommus = <&vop_mmu>;
		rockchip,grf = <&grf>;
		status = "okay";
		esmart_lb_mode = [03];
		support-multi-area;
		phandle = <0xea>;

		vop_out: ports {
			#address-cells = <0x01>;
			#size-cells = <0x00>;
			phandle = <0x14>;

			port@0 {
				#address-cells = <0x01>;
				#size-cells = <0x00>;
				reg = <0x00>;

				vp0_out_hdmi: endpoint@0 {
					reg = <0x00>;
					remote-endpoint = <&hdmi_in_vp0>;
					phandle = <0x17>;
				};
			};

			port@1 {
				#address-cells = <0x01>;
				#size-cells = <0x00>;
				reg = <0x01>;

				vp1_out_tve: endpoint@0 {
					reg = <0x00>;
					remote-endpoint = <&tve_in_vp1>;
					phandle = <0x18>;
				};
			};
		};
	};

	vop_mmu: iommu@ff847e00 {
		compatible = "rockchip,iommu-v2";
		reg = <0x00 0xff847e00 0x00 0x100>;
		interrupts = <0x00 0x6d 0x04>;
		interrupt-names = "vop_mmu";
		clocks = <&cru 0x157 &cru 0x154>;
		clock-names = "aclk", "iface";
		#iommu-cells = <0x00>;
		rockchip,disable-device-link-resume;
		rockchip,shootdown-entire;
		status = "okay";
		phandle = <0x34>;
	};

	rga2: rga@ff850000 {
		compatible = "rockchip,rga2_core0";
		reg = <0x00 0xff850000 0x00 0x1000>;
		interrupts = <0x00 0x69 0x04>;
		interrupt-names = "rga2_irq";
		clocks = <&cru 0x14b &cru 0x14a &cru 0x14c>;
		clock-names = "aclk_rga2", "hclk_rga2", "clk_rga2";
		iommus = <&rga2_mmu>;
		rockchip,grf = <&grf>;
		rockchip,grf-offset = <0x600e0>;
		rockchip,grf-values = <0xff10000 0xff10ff1>;
		status = "okay";
		phandle = <0xeb>;
	};

	rga2_mmu: iommu@ff850f00 {
		compatible = "rockchip,iommu-v2";
		reg = <0x00 0xff850f00 0x00 0x100>;
		interrupts = <0x00 0x69 0x04>;
		interrupt-names = "rga2_mmu";
		clocks = <&cru 0x14b &cru 0x14a>;
		clock-names = "aclk", "iface";
		#iommu-cells = <0x00>;
		status = "okay";
		phandle = <0x37>;
	};

	iep: iep@ff860000 {
		compatible = "rockchip,iep-v2";
		reg = <0x00 0xff860000 0x00 0x500>;
		interrupts = <0x00 0x6a 0x04>;
		clocks = <&cru 0x14e &cru 0x14d &cru 0x14f>;
		clock-names = "aclk", "hclk", "sclk";
		rockchip,normal-rates = <0x1443fd00 0x00 0x1443fd00>;
		assigned-clocks = <&cru 0x14e &cru 0x14f>;
		assigned-clock-rates = <0x1443fd00 0x1443fd00>;
		resets = <&cru 0x27b &cru 0x27a &cru 0x27c>;
		reset-names = "shared_rst_a", "shared_rst_h", "shared_rst_s";
		rockchip,srv = <&mpp_srv>;
		rockchip,taskqueue-node = <&cpu0>;
		rockchip,resetgroup-node = <&cpu0>;
		iommus = <&iep_mmu>;
		status = "okay";
		phandle = <0xec>;
	};

	iep_mmu: iommu@ff860800 {
		compatible = "rockchip,iommu-v2";
		reg = <0x00 0xff860800 0x00 0x100>;
		interrupts = <0x00 0x6a 0x04>;
		interrupt-names = "iep_mmu";
		clocks = <&cru 0x14e &cru 0x14d>;
		clock-names = "aclk", "iface";
		#iommu-cells = <0x00>;
		rockchip,shootdown-entire;
		status = "okay";
		phandle = <0x38>;
	};

	vdpp: vdpp@ff861000 {
		compatible = "rockchip,vdpp-v1";
		reg = <0x00 0xff861000 0x00 0x100 0x00 0xff862000 0x00 0x900>;
		reg-names = "vdpp_regs", "zme_regs";
		interrupts = <0x00 0x6a 0x04>;
		clocks = <&cru 0x14e &cru 0x14d &cru 0x14f>;
		clock-names = "aclk", "hclk", "sclk";
		rockchip,normal-rates = <0x1443fd00 0x00 0x1443fd00>;
		assigned-clocks = <&cru 0x14e &cru 0x14f>;
		assigned-clock-rates = <0x1443fd00 0x1443fd00>;
		resets = <&cru 0x27b &cru 0x27a &cru 0x27c>;
		reset-names = "shared_rst_a", "shared_rst_h", "shared_rst_s";
		rockchip,srv = <&mpp_srv>;
		rockchip,grf = <&grf>;
		rockchip,grf-mem-offset = <0x600e0>;
		rockchip,grf-mem-values = <0xf0040000 0xf004f004>;
		rockchip,taskqueue-node = <&cpu0>;
		rockchip,resetgroup-node = <&cpu0>;
		rockchip,disable-auto-freq;
		iommus = <&iep_mmu>;
		status = "okay";
		phandle = <0xed>;
	};

	jpegd: jpegd@ff870000 {
		compatible = "rockchip,rkv-jpeg-decoder-v1";
		reg = <0x00 0xff870000 0x00 0x400>;
		interrupts = <0x00 0x6b 0x04>;
		clocks = <&cru 0x169 &cru 0x16a>;
		clock-names = "aclk_vcodec", "hclk_vcodec";
		rockchip,normal-rates = <0x1443fd00 0x00>;
		assigned-clocks = <&cru 0x169>;
		assigned-clock-rates = <0x1443fd00>;
		rockchip,disable-auto-freq;
		resets = <&cru 0x296 &cru 0x297>;
		reset-names = "video_a", "video_h";
		iommus = <&jpegd_mmu>;
		rockchip,srv = <&mpp_srv>;
		rockchip,taskqueue-node = <&cpu1>;
		rockchip,resetgroup-node = <&cpu1>;
		status = "okay";
		phandle = <0xee>;
	};

	jpegd_mmu: iommu@ff870480 {
		compatible = "rockchip,iommu-v2";
		reg = <0x00 0xff870480 0x00 0x40>;
		interrupts = <0x00 0x6c 0x04>;
		interrupt-names = "jpegd_mmu";
		clock-names = "aclk", "iface";
		clocks = <&cru 0x169 &cru 0x16a>;
		#iommu-cells = <0x00>;
		rockchip,shootdown-entire;
		status = "okay";
		phandle = <0x39>;
	};

	tve: tve@ff880000 {
		compatible = "rockchip,rk3528-tve";
		reg = <0x00 0xff880000 0x00 0x4000 0x00 0xffde0000 0x00 0x300>;
		interrupts = <0x00 0x70 0x04>;
		clocks = <&cru 0x166 &cru 0x18f &cru 0x167 &cru 0x168>;
		clock-names = "hclk", "pclk_vdac", "dclk", "dclk_4x";
		rockchip,lumafilter0 = <0xff80006>;
		rockchip,lumafilter1 = <0x90010>;
		rockchip,lumafilter2 = <0xffb0fd8>;
		rockchip,lumafilter3 = <0x80057>;
		rockchip,lumafilter4 = <0xfef0f64>;
		rockchip,lumafilter5 = <0x16010a>;
		rockchip,lumafilter6 = <0xf830df7>;
		rockchip,lumafilter7 = <0x8de055f>;
		rockchip,tve-upsample = <0x02>;
		rockchip,grf = <&grf>;
		nvmem-cells = <&vdac_out_current &test_version>;
		nvmem-cell-names = "out-current", "version";
		status = "okay";
		phandle = <0xef>;

		ports {
			#address-cells = <0x01>;
			#size-cells = <0x00>;

			port@0 {
				reg = <0x00>;
				#address-cells = <0x01>;
				#size-cells = <0x00>;

				tve_in_vp1: endpoint@0 {
					reg = <0x00>;
					remote-endpoint = <&vp1_out_tve>;
					status = "okay";
					phandle = <0x36>;
				};
			};
		};
	};

	hdcp2: hdcp2@ff8c0000 {
		compatible = "rockchip,rk3528-hdmi-hdcp2";
		reg = <0x00 0xff8c0000 0x00 0x2000>;
		interrupts = <0x00 0x68 0x04>;
		clocks = <&cru 0x163 &cru 0x165 &cru 0x164>;
		clock-names = "aclk_hdcp2", "pclk_hdcp2", "hdcp2_clk_hdmi";
		status = "disabled";
		phandle = <0xf0>;
	};

	hdmi: hdmi@ff8d0000 {
		compatible = "rockchip,rk3528-dw-hdmi";
		reg = <0x00 0xff8d0000 0x00 0x20000 0x00 0xff610000 0x00 0x200>;
		interrupts = <0x00 0x66 0x04 0x00 0x67 0x04>;
		interrupt-names = "hdmi", "hdmi_wakeup";
		clocks = <&cru 0x158 &cru 0x159 &cru 0x15a &inno_hdmiphy_clk>;
		clock-names = "iahb", "isfr", "cec", "dclk_vp0";
		ddc-i2c-scl-high-time-ns = <0x2599>;
		ddc-i2c-scl-low-time-ns = <0x2710>;
		reg-io-width = <0x04>;
		rockchip,grf = <&grf>;
		rockchip,cts-manual;
		pinctrl-names = "default";
		pinctrl-0 = <&hdmi_pins>;
		phys = <&hdmiphy>;
		phy-names = "hdmi";
		#sound-dai-cells = <0x00>;
		hpd-gpios = <&gpio0 0x02 0x00>;
		status = "okay";
		phandle = <0x98>;

		ports {
			#address-cells = <0x01>;
			#size-cells = <0x00>;

			port@0 {
				reg = <0x00>;
				#address-cells = <0x01>;
				#size-cells = <0x00>;

				hdmi_in_vp0: endpoint@0 {
					reg = <0x00>;
					remote-endpoint = <&vp0_out_hdmi>;
					status = "okay";
					phandle = <0x35>;
				};
			};
		};
	};

	dfi: dfi@ff930000 {
		reg = <0x00 0xff930000 0x00 0x400>;
		compatible = "rockchip,rk3528-dfi";
		rockchip,grf = <&grf>;
		status = "okay";
		phandle = <0x19>;
	};

	spi0: spi@ff9c0000 {
		compatible = "rockchip,rk3066-spi";
		reg = <0x00 0xff9c0000 0x00 0x1000>;
		interrupts = <0x00 0x83 0x04>;
		#address-cells = <0x01>;
		#size-cells = <0x00>;
		clocks = <&cru 0x12a &cru 0x129 &cru 0x12b>;
		clock-names = "spiclk", "apb_pclk", "sclk_in";
		dmas = <&dmac 0x19 &dmac 0x18>;
		dma-names = "tx", "rx";
		pinctrl-names = "default";
		pinctrl-0 = <&spi0_csn0 &spi0_csn1 &spi0_pins>;
		status = "disabled";
		phandle = <0xf1>;
	};

	spi1: spi@ff9d0000 {
		compatible = "rockchip,rk3066-spi";
		reg = <0x00 0xff9d0000 0x00 0x1000>;
		interrupts = <0x00 0x84 0x04>;
		#address-cells = <0x01>;
		#size-cells = <0x00>;
		clocks = <&cru 0xbe &cru 0xbd &cru 0xbf>;
		clock-names = "spiclk", "apb_pclk", "sclk_in";
		dmas = <&dmac 0x1f &dmac 0x1e>;
		dma-names = "tx", "rx";
		pinctrl-names = "default";
		pinctrl-0 = <&spi1_csn0 &spi1_csn1 &spi1_pins>;
		status = "disabled";
		phandle = <0xf2>;
	};

	uart0: serial@ff9f0000 {
		compatible = "rockchip,rk3528-uart", "snps,dw-apb-uart";
		reg = <0x00 0xff9f0000 0x00 0x100>;
		interrupts = <0x00 0x28 0x04>;
		clocks = <&cru 0x15 &cru 0x75>;
		clock-names = "baudclk", "apb_pclk";
		reg-shift = <0x02>;
		reg-io-width = <0x04>;
		dmas = <&dmac 0x09 &dmac 0x08>;
		/* the debug header, as ttyS0; fiq-debugger below gives up this same UART */
		pinctrl-names = "default";
		pinctrl-0 = <&uart0m0_xfer>;
		status = "okay";
		phandle = <0xf3>;
	};

	uart1: serial@ff9f8000 {
		compatible = "rockchip,rk3528-uart", "snps,dw-apb-uart";
		reg = <0x00 0xff9f8000 0x00 0x100>;
		interrupts = <0x00 0x29 0x04>;
		clocks = <&cru 0x18 &cru 0x13b>;
		clock-names = "baudclk", "apb_pclk";
		reg-shift = <0x02>;
		reg-io-width = <0x04>;
		dmas = <&dmac 0x0b &dmac 0x0a>;
		status = "disabled";
		phandle = <0xf4>;
	};

	uart2: serial@ffa00000 {
		compatible = "rockchip,rk3528-uart", "snps,dw-apb-uart";
		reg = <0x00 0xffa00000 0x00 0x100>;
		interrupts = <0x00 0x2a 0x04>;
		clocks = <&cru 0x1b &cru 0xc0>;
		clock-names = "baudclk", "apb_pclk";
		reg-shift = <0x02>;
		reg-io-width = <0x04>;
		dmas = <&dmac 0x0d &dmac 0x0c>;
		status = "okay";
		pinctrl-names = "default";
		pinctrl-0 = <&uart2m1_xfer &uart2m1_ctsn>;
		phandle = <0xf5>;
	};

	uart3: serial@ffa08000 {
		compatible = "rockchip,rk3528-uart", "snps,dw-apb-uart";
		reg = <0x00 0xffa08000 0x00 0x100>;
		interrupts = <0x00 0x2b 0x04>;
		clocks = <&cru 0x1e &cru 0x13d>;
		clock-names = "baudclk", "apb_pclk";
		reg-shift = <0x02>;
		reg-io-width = <0x04>;
		dmas = <&dmac 0x0f &dmac 0x0e>;
		status = "disabled";
		phandle = <0xf6>;
	};

	uart4: serial@ffa10000 {
		compatible = "rockchip,rk3528-uart", "snps,dw-apb-uart";
		reg = <0x00 0xffa10000 0x00 0x100>;
		interrupts = <0x00 0x2c 0x04>;
		clocks = <&cru 0x21 &cru 0x1a4>;
		clock-names = "baudclk", "apb_pclk";
		reg-shift = <0x02>;
		reg-io-width = <0x04>;
		dmas = <&dmac 0x11 &dmac 0x10>;
		status = "disabled";
		phandle = <0xf7>;
	};

	uart5: serial@ffa18000 {
		compatible = "rockchip,rk3528-uart", "snps,dw-apb-uart";
		reg = <0x00 0xffa18000 0x00 0x100>;
		interrupts = <0x00 0x2d 0x04>;
		clocks = <&cru 0x24 &cru 0xc2>;
		clock-names = "baudclk", "apb_pclk";
		reg-shift = <0x02>;
		reg-io-width = <0x04>;
		dmas = <&dmac 0x13 &dmac 0x12>;
		status = "disabled";
		phandle = <0xf8>;
	};

	uart6: serial@ffa20000 {
		compatible = "rockchip,rk3528-uart", "snps,dw-apb-uart";
		reg = <0x00 0xffa20000 0x00 0x100>;
		interrupts = <0x00 0x2e 0x04>;
		clocks = <&cru 0x27 &cru 0xc4>;
		clock-names = "baudclk", "apb_pclk";
		reg-shift = <0x02>;
		reg-io-width = <0x04>;
		dmas = <&dmac 0x15 &dmac 0x14>;
		status = "disabled";
		phandle = <0xf9>;
	};

	uart7: serial@ffa28000 {
		compatible = "rockchip,rk3528-uart", "snps,dw-apb-uart";
		reg = <0x00 0xffa28000 0x00 0x100>;
		interrupts = <0x00 0x2f 0x04>;
		clocks = <&cru 0x2a &cru 0xc6>;
		clock-names = "baudclk", "apb_pclk";
		reg-shift = <0x02>;
		reg-io-width = <0x04>;
		dmas = <&dmac 0x17 &dmac 0x16>;
		status = "disabled";
		phandle = <0xfa>;
	};

	i2c0: i2c@ffa50000 {
		compatible = "rockchip,rk3528-i2c", "rockchip,rk3399-i2c";
		reg = <0x00 0xffa50000 0x00 0x1000>;
		clocks = <&cru 0x127 &cru 0x126>;
		clock-names = "i2c", "pclk";
		interrupts = <0x00 0x3d 0x04>;
		pinctrl-names = "default";
		pinctrl-0 = <&i2c0m0_xfer>;
		#address-cells = <0x01>;
		#size-cells = <0x00>;
		status = "disabled";
		phandle = <0xfb>;
	};

	i2c1: i2c@ffa58000 {
		compatible = "rockchip,rk3528-i2c", "rockchip,rk3399-i2c";
		reg = <0x00 0xffa58000 0x00 0x1000>;
		clocks = <&cru 0x125 &cru 0x124>;
		clock-names = "i2c", "pclk";
		interrupts = <0x00 0x3e 0x04>;
		pinctrl-names = "default";
		pinctrl-0 = <&i2c1m0_xfer>;
		#address-cells = <0x01>;
		#size-cells = <0x00>;
		status = "disabled";
		phandle = <0xfc>;
	};

	i2c2: i2c@ffa60000 {
		compatible = "rockchip,rk3528-i2c", "rockchip,rk3399-i2c";
		reg = <0x00 0xffa60000 0x00 0x1000>;
		clocks = <&cru 0x1f2 &cru 0x1f1>;
		clock-names = "i2c", "pclk";
		interrupts = <0x00 0x3f 0x04>;
		pinctrl-names = "default";
		pinctrl-0 = <&i2c2m0_xfer>;
		#address-cells = <0x01>;
		#size-cells = <0x00>;
		status = "disabled";
		phandle = <0xfd>;
	};

	i2c3: i2c@ffa68000 {
		compatible = "rockchip,rk3528-i2c", "rockchip,rk3399-i2c";
		reg = <0x00 0xffa68000 0x00 0x1000>;
		clocks = <&cru 0xc9 &cru 0xc8>;
		clock-names = "i2c", "pclk";
		interrupts = <0x00 0x40 0x04>;
		pinctrl-names = "default";
		pinctrl-0 = <&i2c3m0_xfer>;
		#address-cells = <0x01>;
		#size-cells = <0x00>;
		status = "disabled";
		phandle = <0xfe>;
	};

	i2c4: i2c@ffa70000 {
		compatible = "rockchip,rk3528-i2c", "rockchip,rk3399-i2c";
		reg = <0x00 0xffa70000 0x00 0x1000>;
		clocks = <&cru 0x1a7 &cru 0x1a6>;
		clock-names = "i2c", "pclk";
		interrupts = <0x00 0x41 0x04>;
		pinctrl-names = "default";
		pinctrl-0 = <&i2c4_xfer>;
		#address-cells = <0x01>;
		#size-cells = <0x00>;
		status = "disabled";
		phandle = <0xff>;
	};

	i2c5: i2c@ffa78000 {
		compatible = "rockchip,rk3528-i2c", "rockchip,rk3399-i2c";
		reg = <0x00 0xffa78000 0x00 0x1000>;
		clocks = <&cru 0xcb &cru 0xca>;
		clock-names = "i2c", "pclk";
		interrupts = <0x00 0x42 0x04>;
		pinctrl-names = "default";
		pinctrl-0 = <&i2c5m0_xfer>;
		#address-cells = <0x01>;
		#size-cells = <0x00>;
		status = "disabled";
		phandle = <0x100>;
	};

	i2c6: i2c@ffa80000 {
		compatible = "rockchip,rk3528-i2c", "rockchip,rk3399-i2c";
		reg = <0x00 0xffa80000 0x00 0x1000>;
		clocks = <&cru 0xcd &cru 0xcc>;
		clock-names = "i2c", "pclk";
		interrupts = <0x00 0x43 0x04>;
		pinctrl-names = "default";
		pinctrl-0 = <&i2c6m0_xfer>;
		#address-cells = <0x01>;
		#size-cells = <0x00>;
		status = "disabled";
		phandle = <0x101>;

		es7243e: es7243e@10 {
			status = "okay";
			#sound-dai-cells = <0x00>;
			compatible = "ES7243E_MicArray_0";
			reg = <0x10>;
			phandle = <0x96>;
		};

		es7243e_11: es7243e@11 {
			status = "okay";
			#sound-dai-cells = <0x00>;
			compatible = "ES7243E_MicArray_1";
			reg = <0x11>;
			phandle = <0x102>;
		};

		es7243e_12: es7243e@12 {
			status = "okay";
			#sound-dai-cells = <0x00>;
			compatible = "ES7243E_MicArray_2";
			reg = <0x12>;
			phandle = <0x103>;
		};
	};

	i2c7: i2c@ffa88000 {
		compatible = "rockchip,rk3528-i2c", "rockchip,rk3399-i2c";
		reg = <0x00 0xffa88000 0x00 0x1000>;
		clocks = <&cru 0x1a9 &cru 0x1a8>;
		clock-names = "i2c", "pclk";
		interrupts = <0x00 0x44 0x04>;
		pinctrl-names = "default";
		pinctrl-0 = <&i2c7_xfer>;
		#address-cells = <0x01>;
		#size-cells = <0x00>;
		status = "disabled";
		phandle = <0x104>;
	};

	pwm0: pwm@ffa90000 {
		compatible = "rockchip,rk3528-pwm", "rockchip,rk3328-pwm";
		reg = <0x00 0xffa90000 0x00 0x10>;
		interrupts = <0x00 0x35 0x04>;
		#pwm-cells = <0x03>;
		pinctrl-names = "active";
		pinctrl-0 = <&pwm0m0_pins>;
		clocks = <&cru 0x7f &cru 0x7e>;
		clock-names = "pwm", "pclk";
		status = "okay";
		phandle = <0x105>;
	};

	pwm1: pwm@ffa90010 {
		compatible = "rockchip,rk3528-pwm", "rockchip,rk3328-pwm";
		reg = <0x00 0xffa90010 0x00 0x10>;
		interrupts = <0x00 0x35 0x04>;
		#pwm-cells = <0x03>;
		pinctrl-names = "active";
		pinctrl-0 = <&pwm1m0_pins>;
		clocks = <&cru 0x7f &cru 0x7e>;
		clock-names = "pwm", "pclk";
		status = "okay";
		phandle = <0xa2>;
	};

	pwm2: pwm@ffa90020 {
		compatible = "rockchip,rk3528-pwm", "rockchip,rk3328-pwm";
		reg = <0x00 0xffa90020 0x00 0x10>;
		interrupts = <0x00 0x35 0x04>;
		#pwm-cells = <0x03>;
		pinctrl-names = "active";
		pinctrl-0 = <&pwm2m0_pins>;
		clocks = <&cru 0x7f &cru 0x7e>;
		clock-names = "pwm", "pclk";
		status = "okay";
		phandle = <0x106>;
	};

	pwm3: pwm@ffa90030 {
		compatible = "rockchip,remotectl-pwm";
		reg = <0x00 0xffa90030 0x00 0x10>;
		interrupts = <0x00 0x35 0x04 0x00 0x36 0x04>;
		#pwm-cells = <0x03>;
		pinctrl-names = "default";
		pinctrl-0 = <&pwm3m0_pins>;
		clocks = <&cru 0x7f &cru 0x7e>;
		clock-names = "pwm", "pclk";
		status = "okay";
		remote_pwm_id = <0x03>;
		handle_cpu_id = <0x01>;
		/* IR as an ATF wake source, so the remote can power the box on */
		remote_support_psci = <0x01>;
		phandle = <0x107>;

		ir_key1 {
			rockchip,usercode = <0x4040>;
			rockchip,key_table = <0xf2 0xe8 0xba 0x9e 0xf4 0x67 0xf1 0x6c 0xef 0x69 0xee 0x6a 0xbd 0x66 0xea 0x73 0xe3 0x72 0xe2 0xd9 0xb2 0x74 0xbc 0x71 0xec 0x8b 0xbf 0x190 0xe0 0x191 0xe1 0x192 0xe9 0xb7 0xe6 0xf8 0xe8 0xb9 0xe7 0xba 0xf0 0x184 0xbe 0x175>;
		};

		ir_key2 {
			rockchip,usercode = <0xff00>;
			rockchip,key_table = <0xf9 0x66 0xbf 0x9e 0xfb 0x8b 0xaa 0xe8 0xb9 0x67 0xe9 0x6c 0xb8 0x69 0xea 0x6a 0xeb 0x72 0xef 0x73 0xf7 0x71 0xe7 0x74 0xfc 0x74 0xa9 0x72 0xa8 0xa4 0xe0 0x72 0xa5 0x72 0xab 0xb7 0xb7 0x184 0xe8 0x184 0xf8 0xb8 0xaf 0xb9 0xed 0x72 0xee 0xba 0xb3 0x72 0xf1 0x72 0xf2 0x72 0xf3 0xd9 0xb4 0x72 0xa4 0x8d 0xbe 0xd9>;
		};

		ir_key3 {
			rockchip,usercode = <0x1dcc>;
			rockchip,key_table = <0xee 0xe8 0xf0 0x9e 0xf8 0x67 0xbb 0x6c 0xef 0x69 0xed 0x6a 0xfc 0x66 0xf1 0x73 0xfd 0x72 0xb7 0xd9 0xff 0x74 0xf3 0x71 0xbf 0x8b 0xf9 0x191 0xf5 0x192 0xb3 0x184 0xbe 0x02 0xba 0x03 0xb2 0x04 0xbd 0x05 0xf9 0x06 0xb1 0x07 0xfc 0x08 0xf8 0x09 0xb0 0x0a 0xb6 0x0b 0xb5 0x0e>;
		};

		ir_key4 {
			rockchip,usercode = <0x7f80>;
			rockchip,key_table = <0xec 0xe8 0xd8 0x9e 0xc7 0x67 0xbf 0x6c 0xc8 0x69 0xc6 0x6a 0x8c 0x66 0x78 0x73 0x76 0x72 0x7e 0x74 0x7c 0x8b 0xb7 0x184>;
		};

		ir_key5 {
			rockchip,usercode = <0xfeaa>;
			rockchip,key_table = <0xec 0xe8 0xe6 0x9e 0xe9 0x67 0xe5 0x6c 0xae 0x69 0xaf 0x6a 0xee 0x66 0xe7 0x73 0xef 0x72 0xbf 0x74 0xbe 0x71 0xb3 0x8b 0xff 0x184 0xb1 0x18e 0xf2 0x18f 0xf3 0x04 0xb5 0x05 0xf6 0x06 0xf7 0x07 0xb9 0x190 0xfa 0x191 0xfb 0x0a 0xfe 0x0b 0xbd 0x0e 0xbc 0xb7 0xf0 0xba 0xb4 0x19c 0xb8 0x1e 0xb0 0x197>;
		};

		ir_key6 {
			rockchip,usercode = <0xfb04>;
			rockchip,key_table = <0xf7 0x74 0xd0 0x184 0xb5 0x8b 0x5b 0xb8 0x4d 0xb7 0xba 0x67 0xb9 0x6c 0xb8 0x69 0xb7 0x6a 0xbb 0xe8 0xe5 0x9e 0xe4 0x0e 0xd2 0x66 0xfd 0x73 0xfc 0x72 0xf6 0x71 0xff 0x192 0xfe 0x193 0x04 0x40 0x14 0x41 0x4c 0x42 0x4b 0x43>;
		};

		ir_key7 {
			rockchip,usercode = <0xfe01>;
			rockchip,key_table = <0xec 0xe8 0xe6 0x9e 0xe9 0x67 0xe5 0x6c 0xae 0x69 0xaf 0x6a 0xee 0x66 0xe7 0x73 0xef 0x72 0xbf 0x74 0xbe 0x71 0xb3 0x8b 0xff 0x184 0xb1 0x02 0xf2 0x03 0xf3 0x04 0xb5 0x05 0xf6 0x06 0xf7 0x07 0xb9 0x08 0xfa 0x09 0xfb 0x0a 0xfe 0x0b 0xbd 0x0e 0xbc 0xb7 0xf0 0xba 0xb4 0x19c 0xb8 0x1e 0xb0 0x197>;
		};

		ir_key8 {
			rockchip,usercode = <0xdd22>;
			rockchip,key_table = <0x31 0xe8 0x6a 0x9e 0x35 0x67 0x2d 0x6c 0x66 0x69 0x3e 0x6a 0x7f 0x73 0x7e 0x72 0x23 0x74 0x63 0x71 0x6d 0x02 0x6c 0x03 0x33 0x04 0x71 0x05 0x70 0x06 0x37 0x07 0x75 0x08 0x74 0x09 0x3b 0x0a 0x78 0x0b 0x73 0x6d 0x22 0x68 0x72 0x8d 0x7a 0xf9 0x79 0xfa 0x77 0xfb 0x2f 0xfc 0x32 0xfd 0x6e 0xfe 0x7c 0xff 0x3c 0x100 0x3a 0x8a 0x67 0x101 0x25 0x103 0x7d 0x8b 0x3f 0x0d 0x29 0x184 0x26 0xa4 0x76 0x191 0x7b 0x190 0x69 0x42>;
		};

		ir_key9 {
			rockchip,usercode = <0x3bc4>;
			rockchip,key_table = <0x81 0xe8 0x80 0x9e 0x85 0x67 0x87 0x6c 0x84 0x69 0x86 0x6a 0x99 0x73 0x9a 0x72 0x96 0x74 0x9b 0x71 0x89 0x02 0x8a 0x03 0x8b 0x04 0x8c 0x05 0x8d 0x06 0x8e 0x07 0x8f 0x08 0x90 0x09 0x91 0x0a 0x88 0x0b 0x83 0x6d 0x82 0x68 0x95 0x8d 0x97 0xf9 0x98 0xfa 0xc6 0x104 0xd6 0xfb 0xd7 0x10e 0xcc 0xfc 0xc3 0x108 0xd1 0xfd 0xd2 0xfe 0xd3 0xff 0xd4 0x100 0xc7 0xfd 0xc8 0xfe 0xc9 0xff 0xca 0x100 0xcd 0x109 0xce 0x10a 0xcf 0x8a 0xd0 0x10b 0x9c 0x101 0x93 0x102 0x92 0x103 0xc0 0x6b 0xc1 0x107 0x9d 0xa4 0xc4 0x80 0x94 0x0d 0x9e 0x190 0x9f 0x191 0xcb 0x105 0xc5 0x106>;
		};
	};

	pwm4: pwm@ffa98000 {
		compatible = "rockchip,rk3528-pwm", "rockchip,rk3328-pwm";
		reg = <0x00 0xffa98000 0x00 0x10>;
		interrupts = <0x00 0x37 0x04>;
		#pwm-cells = <0x03>;
		pinctrl-names = "active";
		pinctrl-0 = <&pwm4m0_pins>;
		clocks = <&cru 0x82 &cru 0x81>;
		clock-names = "pwm", "pclk";
		status = "disabled";
		phandle = <0x108>;
	};

	pwm5: pwm@ffa98010 {
		compatible = "rockchip,rk3528-pwm", "rockchip,rk3328-pwm";
		reg = <0x00 0xffa98010 0x00 0x10>;
		interrupts = <0x00 0x37 0x04>;
		#pwm-cells = <0x03>;
		pinctrl-names = "active";
		pinctrl-0 = <&pwm5m0_pins>;
		clocks = <&cru 0x82 &cru 0x81>;
		clock-names = "pwm", "pclk";
		status = "disabled";
		phandle = <0x109>;
	};

	pwm6: pwm@ffa98020 {
		compatible = "rockchip,rk3528-pwm", "rockchip,rk3328-pwm";
		reg = <0x00 0xffa98020 0x00 0x10>;
		interrupts = <0x00 0x37 0x04>;
		#pwm-cells = <0x03>;
		pinctrl-names = "active";
		pinctrl-0 = <&pwm6m0_pins>;
		clocks = <&cru 0x82 &cru 0x81>;
		clock-names = "pwm", "pclk";
		status = "disabled";
		phandle = <0x10a>;
	};

	pwm7: pwm@ffa98030 {
		compatible = "rockchip,rk3528-pwm", "rockchip,rk3328-pwm";
		reg = <0x00 0xffa98030 0x00 0x10>;
		interrupts = <0x00 0x37 0x04 0x00 0x38 0x04>;
		#pwm-cells = <0x03>;
		pinctrl-names = "active";
		pinctrl-0 = <&pwm7m0_pins>;
		clocks = <&cru 0x82 &cru 0x81>;
		clock-names = "pwm", "pclk";
		status = "disabled";
		phandle = <0x10b>;
	};

	rktimer: timer@ffab0000 {
		compatible = "rockchip,rk3528-timer", "rockchip,rk3288-timer";
		reg = <0x00 0xffab0000 0x00 0x20>;
		interrupts = <0x00 0x1f 0x04>;
		clocks = <&cru 0x69 &cru 0x6a>;
		clock-names = "pclk", "timer";
		phandle = <0x10c>;
	};

	wdt: watchdog@ffac0000 {
		compatible = "snps,dw-wdt";
		reg = <0x00 0xffac0000 0x00 0x100>;
		clocks = <&cru 0x73 &cru 0x72>;
		clock-names = "tclk", "pclk";
		interrupts = <0x00 0x1c 0x04>;
		/* /dev/watchdog for systemd RuntimeWatchdogSec - also the only hang recorder */
		status = "okay";
		phandle = <0x10d>;
	};

	tsadc: tsadc@ffad0000 {
		compatible = "rockchip,rk3528-tsadc";
		reg = <0x00 0xffad0000 0x00 0x400>;
		rockchip,grf = <&grf>;
		interrupts = <0x00 0x8b 0x04>;
		clocks = <&cru 0x103 &cru 0x104 &cru 0x102>;
		clock-names = "tsadc", "tsadc_tsen", "apb_pclk";
		assigned-clocks = <&cru 0x103 &cru 0x104>;
		assigned-clock-rates = <0x124f80 0xb71b00>;
		resets = <&cru 0x20f &cru 0x20e>;
		reset-names = "tsadc", "tsadc-apb";
		#thermal-sensor-cells = <0x01>;
		rockchip,hw-tshut-temp = <0x1d4c0>;
		rockchip,hw-tshut-mode = <0x00>;
		rockchip,hw-tshut-polarity = <0x00>;
		nvmem-cells = <&cpu_tsadc_trim_l &cpu_tsadc_trim_h>;
		nvmem-cell-names = "trim_l", "trim_h";
		status = "okay";
		phandle = <0x1f>;
	};

	saradc: saradc@ffae0000 {
		compatible = "rockchip,rk3528-saradc";
		reg = <0x00 0xffae0000 0x00 0x10000>;
		interrupts = <0x00 0x8c 0x04>;
		#io-channel-cells = <0x01>;
		clocks = <&cru 0x101 &cru 0x100>;
		clock-names = "saradc", "apb_pclk";
		resets = <&cru 0x20b>;
		reset-names = "saradc-apb";
		status = "okay";
		vref-supply = <&vdd_1v8_s3>;
		phandle = <0x92>;
	};

	sai3: sai@ffb70000 {
		compatible = "rockchip,rk3528-sai", "rockchip,sai-v1";
		reg = <0x00 0xffb70000 0x00 0x1000>;
		interrupts = <0x00 0x80 0x04>;
		clocks = <&cru 0x184 &cru 0x183>;
		clock-names = "mclk", "hclk";
		assigned-clocks = <&cru 0x184>;
		assigned-clock-rates = <0x5dc000>;
		dmas = <&dmac 0x05>;
		dma-names = "tx";
		resets = <&cru 0x2a2 &cru 0x2a1>;
		reset-names = "m", "h";
		rockchip,always-on;
		#sound-dai-cells = <0x00>;
		status = "okay";
		phandle = <0x97>;
	};

	sai0: sai@ffb80000 {
		compatible = "rockchip,rk3528-sai", "rockchip,sai-v1";
		reg = <0x00 0xffb80000 0x00 0x1000>;
		interrupts = <0x00 0x7d 0x04>;
		clocks = <&cru 0xaf &cru 0xae>;
		clock-names = "mclk", "hclk";
		dmas = <&dmac 0x01 &dmac 0x00>;
		dma-names = "tx", "rx";
		resets = <&cru 0x1aa &cru 0x1a9>;
		reset-names = "m", "h";
		pinctrl-names = "default";
		pinctrl-0 = <&i2s0m0_lrck &i2s0m0_sclk &i2s0m0_sdi &i2s0m0_sdo>;
		#sound-dai-cells = <0x00>;
		status = "okay";
		phandle = <0x93>;
	};

	sai2: sai@ffb90000 {
		compatible = "rockchip,rk3528-sai", "rockchip,sai-v1";
		reg = <0x00 0xffb90000 0x00 0x1000>;
		interrupts = <0x00 0x7f 0x04>;
		clocks = <&cru 0xb1 &cru 0xb0>;
		clock-names = "mclk", "hclk";
		dmas = <&dmac 0x04>;
		dma-names = "tx";
		resets = <&cru 0x1ac &cru 0x1ab>;
		reset-names = "m", "h";
		#sound-dai-cells = <0x00>;
		status = "okay";
		phandle = <0x90>;
	};

	sai1: sai@ffba0000 {
		compatible = "rockchip,rk3528-sai", "rockchip,sai-v1";
		reg = <0x00 0xffba0000 0x00 0x1000>;
		interrupts = <0x00 0x7e 0x04>;
		clocks = <&cru 0x123 &cru 0x122>;
		clock-names = "mclk", "hclk";
		dmas = <&dmac 0x03 &dmac 0x02>;
		dma-names = "tx", "rx";
		resets = <&cru 0x24a &cru 0x249>;
		reset-names = "m", "h";
		pinctrl-names = "default";
		pinctrl-0 = <&i2s1_sclk &i2s1_lrck &i2s1_sdi0 &i2s1_sdi1 &i2s1_sdi2 &i2s1_sdi3 &i2s1_sdo0 &i2s1_sdo1 &i2s1_sdo2 &i2s1_sdo3>;
		#sound-dai-cells = <0x00>;
		status = "disabled";
		phandle = <0x95>;
	};

	pdm: pdm@ffbb0000 {
		compatible = "rockchip,rk3528-pdm", "rockchip,rk3568-pdm";
		reg = <0x00 0xffbb0000 0x00 0x1000>;
		clocks = <&cru 0x137 &cru 0x136>;
		clock-names = "pdm_clk", "pdm_hclk";
		dmas = <&dmac 0x06>;
		dma-names = "rx";
		pinctrl-names = "default";
		pinctrl-0 = <&pdm_clk0 &pdm_clk1 &pdm_sdi0 &pdm_sdi1 &pdm_sdi2 &pdm_sdi3>;
		#sound-dai-cells = <0x00>;
		status = "disabled";
		phandle = <0x99>;
	};

	spdif_8ch: spdif@ffbc0000 {
		compatible = "rockchip,rk3528-spdif", "rockchip,rk3568-spdif";
		reg = <0x00 0xffbc0000 0x00 0x1000>;
		interrupts = <0x00 0x82 0x04>;
		dmas = <&dmac 0x07>;
		dma-names = "tx";
		clock-names = "mclk", "hclk";
		clocks = <&cru 0x135 &cru 0x134>;
		#sound-dai-cells = <0x00>;
		pinctrl-names = "default";
		pinctrl-0 = <&spdifm0_pins>;
		status = "okay";
		phandle = <0x9b>;
	};

	gmac0: ethernet@ffbd0000 {
		compatible = "rockchip,rk3528-gmac", "snps,dwmac-4.20a";
		reg = <0x00 0xffbd0000 0x00 0x10000>;
		interrupts = <0x00 0x71 0x04 0x00 0x74 0x04>;
		interrupt-names = "macirq", "eth_wake_irq";
		rockchip,grf = <&grf>;
		clocks = <&cru 0x17b &cru 0x17c &cru 0x17e &cru 0x17d &cru 0x17a &cru 0x179>;
		clock-names = "stmmaceth", "clk_mac_ref", "mac_clk_rx", "mac_clk_tx", "pclk_mac", "aclk_mac";
		resets = <&cru 0x29a>;
		reset-names = "stmmaceth";
		snps,mixed-burst;
		snps,tso;
		snps,axi-config = <0x70>;
		snps,mtl-rx-config = <0x71>;
		snps,mtl-tx-config = <0x72>;
		phy-mode = "rmii";
		clock_in_out = "input";
		phy-handle = <&rmii0_phy>;
		nvmem-cells = <&macphy_bgs>;
		nvmem-cell-names = "bgs";
		status = "okay";
		phandle = <0x10e>;

		mdio0: mdio {
			compatible = "snps,dwmac-mdio";
			#address-cells = <0x01>;
			#size-cells = <0x00>;
			phandle = <0x10f>;

			rmii0_phy: ethernet-phy@2 {
				compatible = "ethernet-phy-id0044.1400", "ethernet-phy-ieee802.3-c22";
				reg = <0x02>;
				clocks = <&cru 0x18e>;
				resets = <&cru 0x2a3>;
				phy-is-integrated;
				pinctrl-names = "default";
				pinctrl-0 = <&fephym0_led_link &fephym0_led_spd>;
				nvmem-cells = <&macphy_txlevel>;
				nvmem-cell-names = "txlevel";
				rockchip,thermal-zone = "soc-thermal";
				phandle = <0x73>;
			};
		};

		gmac0_stmmac_axi_setup: stmmac-axi-config {
			snps,wr_osr_lmt = <0x04>;
			snps,rd_osr_lmt = <0x08>;
			snps,blen = <0x00 0x00 0x00 0x00 0x10 0x08 0x04>;
			phandle = <0x70>;
		};

		gmac0_mtl_rx_setup: rx-queues-config {
			snps,rx-queues-to-use = <0x01>;
			phandle = <0x71>;

			queue0 {
			};
		};

		gmac0_mtl_tx_setup: tx-queues-config {
			snps,tx-queues-to-use = <0x01>;
			phandle = <0x72>;

			queue0 {
			};
		};
	};

	sdhci: mmc@ffbf0000 {
		compatible = "rockchip,rk3528-dwcmshc";
		reg = <0x00 0xffbf0000 0x00 0x10000>;
		interrupts = <0x00 0x88 0x04>;
		assigned-clocks = <&cru 0xa6 &cru 0xa7 &cru 0xa3>;
		assigned-clock-rates = <0xbebc200 0x16e3600 0xbebc200>;
		clocks = <&cru 0xa3 &cru 0xa4 &cru 0xa5 &cru 0xa6 &cru 0xa7>;
		clock-names = "core", "bus", "axi", "block", "timer";
		resets = <&cru 0x19f &cru 0x1a0 &cru 0x1a1 &cru 0x1a2 &cru 0x1a3>;
		reset-names = "core", "bus", "axi", "block", "timer";
		max-frequency = <0x5f5e100>;
		status = "okay";
		bus-width = <0x08>;
		no-sd;
		no-sdio;
		non-removable;
		mmc-hs200-1_8v;
		phandle = <0x110>;
	};

	sfc: spi@ffc00000 {
		compatible = "rockchip,sfc";
		reg = <0x00 0xffc00000 0x00 0x4000>;
		interrupts = <0x00 0x87 0x04>;
		clocks = <&cru 0xa1 &cru 0xa0>;
		clock-names = "clk_sfc", "hclk_sfc";
		assigned-clocks = <&cru 0xa1>;
		assigned-clock-rates = <0x5f5e100>;
		#address-cells = <0x01>;
		#size-cells = <0x00>;
		status = "okay";
		phandle = <0x111>;
	};

	sdio0: mmc@ffc10000 {
		compatible = "rockchip,rk3528-dw-mshc", "rockchip,rk3288-dw-mshc";
		reg = <0x00 0xffc10000 0x00 0x4000>;
		interrupts = <0x00 0x89 0x04>;
		max-frequency = <0x8f0d180>;
		clocks = <&cru 0xf1 &cru 0xf0 &grf_cru 0x03 &grf_cru 0x04>;
		clock-names = "biu", "ciu", "ciu-drive", "ciu-sample";
		fifo-depth = <0x100>;
		resets = <&cru 0x202>;
		reset-names = "reset";
		rockchip,use-v2-tuning;
		status = "disabled";
		phandle = <0x112>;
	};

	sdio1: mmc@ffc20000 {
		compatible = "rockchip,rk3528-dw-mshc", "rockchip,rk3288-dw-mshc";
		reg = <0x00 0xffc20000 0x00 0x4000>;
		interrupts = <0x00 0x8a 0x04>;
		max-frequency = <0xbebc200>;
		clocks = <&cru 0xf5 &cru 0xf4 &grf_cru 0x05 &grf_cru 0x06>;
		clock-names = "biu", "ciu", "ciu-drive", "ciu-sample";
		fifo-depth = <0x100>;
		resets = <&cru 0x204>;
		reset-names = "reset";
		status = "okay";
		no-sd;
		no-mmc;
		supports-sdio;
		bus-width = <0x04>;
		disable-wp;
		cap-sd-highspeed;
		cap-sdio-irq;
		keep-power-in-suspend;
		non-removable;
		mmc-pwrseq = <&sdio_pwrseq>;
		pinctrl-names = "default";
		pinctrl-0 = <&sdio1_bus4 &sdio1_cmd &sdio1_clk>;
		sd-uhs-sdr104;
		phandle = <0x113>;
	};

	sdmmc: mmc@ffc30000 {
		compatible = "rockchip,rk3528-dw-mshc", "rockchip,rk3288-dw-mshc";
		reg = <0x00 0xffc30000 0x00 0x4000>;
		interrupts = <0x00 0x85 0x04>;
		max-frequency = <0x8f0d180>;
		clocks = <&cru 0x198 &cru 0x197 &grf_cru 0x01 &grf_cru 0x02>;
		clock-names = "biu", "ciu", "ciu-drive", "ciu-sample";
		fifo-depth = <0x100>;
		resets = <&cru 0x2a9>;
		reset-names = "reset";
		rockchip,use-v2-tuning;
		status = "okay";
		bus-width = <0x04>;
		cap-mmc-highspeed;
		cap-sd-highspeed;
		disable-wp;
		pinctrl-names = "default";
		pinctrl-0 = <&sdmmc_clk &sdmmc_cmd &sdmmc_det &sdmmc_bus4>;
		rockchip,default-sample-phase = <0x5a>;
		/* sd-uhs-* removed: with UHS the SD intermittently fails to re-initialise after a
		 * warm reset and the box comes up with no root. Costs SDR104, keeps reboots. */
		supports-sd;
		vqmmc-supply = <&vccio_sd>;
		vmmc-supply = <&vcc_sd>;
		phandle = <0x114>;
	};

	crypto: crypto@ffc40000 {
		compatible = "rockchip,crypto-v4";
		reg = <0x00 0xffc40000 0x00 0x2000>;
		interrupts = <0x00 0x13 0x04>;
		clocks = <&scmi_clk 0x18 &scmi_clk 0x1a &scmi_clk 0x17 &scmi_clk 0x19>;
		clock-names = "aclk", "hclk", "sclk", "pka";
		assigned-clocks = <&scmi_clk 0x17 &scmi_clk 0x19>;
		assigned-clock-rates = <0x11e1a300 0x11e1a300>;
		resets = <&cru 0x3a>;
		reset-names = "crypto-rst";
		status = "okay";
		phandle = <0x115>;
	};

	rng: rng@ffc50000 {
		compatible = "rockchip,rkrng";
		reg = <0x00 0xffc50000 0x00 0x200>;
		interrupts = <0x00 0x17 0x04>;
		clocks = <&scmi_clk 0x20>;
		clock-names = "hclk_trng";
		resets = <&cru 0xa3>;
		reset-names = "reset";
		status = "okay";
		phandle = <0x116>;
	};

	otp: otp@ffce0000 {
		compatible = "rockchip,rk3528-otp";
		reg = <0x00 0xffce0000 0x00 0x4000>;
		#address-cells = <0x01>;
		#size-cells = <0x01>;
		clocks = <&cru 0x19d &cru 0x19c &cru 0x19b>;
		clock-names = "usr", "sbpi", "apb";
		resets = <&cru 0x2ad &cru 0x2ac &cru 0x2ab>;
		reset-names = "usr", "sbpi", "apb";
		phandle = <0x117>;

		cpu_code: cpu-code@2 {
			reg = <0x02 0x02>;
			phandle = <0x12>;
		};

		otp_cpu_version: cpu-version@8 {
			reg = <0x08 0x01>;
			bits = <0x03 0x03>;
			phandle = <0x11>;
		};

		cpu_mbist_vmin: cpu-mbist-vmin@9 {
			reg = <0x09 0x01>;
			bits = <0x00 0x03>;
			phandle = <0x0e>;
		};

		gpu_mbist_vmin: gpu-mbist-vmin@9 {
			reg = <0x09 0x01>;
			bits = <0x03 0x02>;
			phandle = <0x2c>;
		};

		logic_mbist_vmin: logic-mbist-vmin@9 {
			reg = <0x09 0x01>;
			bits = <0x05 0x02>;
			phandle = <0x1d>;
		};

		otp_id: id@a {
			reg = <0x0a 0x10>;
			phandle = <0x10>;
		};

		cpu_leakage: cpu-leakage@1a {
			reg = <0x1a 0x01>;
			phandle = <0x0c>;
		};

		log_leakage: log-leakage@1b {
			reg = <0x1b 0x01>;
			phandle = <0x1b>;
		};

		gpu_leakage: gpu-leakage@1c {
			reg = <0x1c 0x01>;
			phandle = <0x2a>;
		};

		test_version: test-version@29 {
			reg = <0x29 0x01>;
			phandle = <0x3b>;
		};

		macphy_bgs: macphy-bgs@2d {
			reg = <0x2d 0x01>;
			phandle = <0x74>;
		};

		macphy_txlevel: macphy-txlevel@2e {
			reg = <0x2e 0x02>;
			phandle = <0x77>;
		};

		vdac_out_current: vdac-out-current@30 {
			reg = <0x30 0x01>;
			phandle = <0x3a>;
		};

		cpu_opp_info: cpu-opp-info@32 {
			reg = <0x32 0x06>;
			phandle = <0x0d>;
		};

		gpu_opp_info: gpu-opp-info@38 {
			reg = <0x38 0x06>;
			phandle = <0x2b>;
		};

		dmc_opp_info: dmc-opp-info@3e {
			reg = <0x3e 0x06>;
			phandle = <0x1c>;
		};

		cpu_tsadc_trim_l: cpu-tsadc-trim-l@44 {
			reg = <0x44 0x01>;
			phandle = <0x58>;
		};

		cpu_tsadc_trim_h: cpu-tsadc-trim-h@45 {
			reg = <0x45 0x01>;
			phandle = <0x59>;
		};

		cpu_code1: cpu-code1@52 {
			reg = <0x52 0x02>;
			phandle = <0x13>;
		};
	};

	dmac: dma-controller@ffd60000 {
		compatible = "arm,pl330", "arm,primecell";
		reg = <0x00 0xffd60000 0x00 0x4000>;
		interrupts = <0x00 0x00 0x04 0x00 0x01 0x04 0x00 0x02 0x04 0x00 0x03 0x04 0x00 0x04 0x04 0x00 0x05 0x04 0x00 0x06 0x04 0x00 0x07 0x04 0x00 0x10 0x04>;
		clocks = <&cru 0x68>;
		clock-names = "apb_pclk";
		#dma-cells = <0x01>;
		arm,pl330-periph-burst;
		phandle = <0x3f>;
	};

	hwlock: hwspinlock@ffd70000 {
		compatible = "rockchip,hwspinlock";
		reg = <0x00 0xffd70000 0x00 0x100>;
		#hwlock-cells = <0x01>;
		status = "disabled";
		phandle = <0x118>;
	};

	combphy_pu: phy@ffdc0000 {
		compatible = "rockchip,rk3528-naneng-combphy";
		reg = <0x00 0xffdc0000 0x00 0x10000>;
		#phy-cells = <0x01>;
		clocks = <&cru 0x91 &cru 0xdc &cru 0xdd>;
		clock-names = "refclk", "apbclk", "pipe_clk";
		assigned-clocks = <&cru 0x91>;
		assigned-clock-rates = <0x5f5e100>;
		resets = <&cru 0x1e6 &cru 0x1e2>;
		reset-names = "combphy-apb", "combphy";
		rockchip,pipe-grf = <&grf>;
		rockchip,pipe-phy-grf = <&grf>;
		status = "okay";
		phandle = <0x23>;
	};

	usb2phy: usb2-phy@ffdf0000 {
		compatible = "rockchip,rk3528-usb2phy";
		reg = <0x00 0xffdf0000 0x00 0x10000>;
		clocks = <&cru 0x1ab &cru 0x1aa>;
		clock-names = "phyclk", "apb_pclk";
		#clock-cells = <0x00>;
		rockchip,usbgrf = <&grf>;
		status = "okay";
		phandle = <0x24>;

		u2phy_otg: otg-port {
			#phy-cells = <0x00>;
			interrupts = <0x00 0x92 0x04 0x00 0x93 0x04 0x00 0x94 0x04>;
			interrupt-names = "otg-bvalid", "otg-id", "linestate";
			status = "okay";
			vbus-supply = <&vcc5v0_otg>;
			phandle = <0x22>;
		};

		u2phy_host: host-port {
			#phy-cells = <0x00>;
			interrupts = <0x00 0x96 0x04>;
			interrupt-names = "linestate";
			status = "okay";
			phy-supply = <&vcc5v0_host>;
			phandle = <0x25>;
		};
	};

	hdmiphy: hdmiphy@ffe00000 {
		compatible = "rockchip,rk3528-hdmi-phy";
		reg = <0x00 0xffe00000 0x00 0x10000>;
		interrupts = <0x00 0x65 0x04>;
		#phy-cells = <0x00>;
		clocks = <&cru 0x160 &xin24m>;
		clock-names = "sysclk", "refclk";
		status = "okay";
		phandle = <0x3d>;

		inno_hdmiphy_clk: clk-port {
			#clock-cells = <0x00>;
			clock-output-names = "clk_hdmiphy_pixel_io";
			status = "okay";
			phandle = <0x33>;
		};
	};

	acodec: acodec@ffe10000 {
		compatible = "rockchip,rk3528-codec";
		reg = <0x00 0xffe10000 0x00 0x1000>;
		#sound-dai-cells = <0x00>;
		clocks = <&cru 0xb2 &cru 0xb3>;
		clock-names = "pclk", "mclk";
		resets = <&cru 0x1ad>;
		reset-names = "acodec";
		status = "okay";
		pa-ctl-gpios = <&gpio0 0x00 0x00>;
		phandle = <0x91>;
	};

	pinctrl: pinctrl {
		compatible = "rockchip,rk3528-pinctrl";
		rockchip,grf = <&ioc_grf>;
		#address-cells = <0x02>;
		#size-cells = <0x02>;
		ranges;
		phandle = <0x87>;

		gpio0: gpio@ff610000 {
			compatible = "rockchip,gpio-bank";
			reg = <0x00 0xff610000 0x00 0x200>;
			interrupts = <0x00 0x47 0x04>;
			clocks = <&cru 0x1fd &cru 0x1fe>;
			gpio-controller;
			#gpio-cells = <0x02>;
			gpio-ranges = <&pinctrl 0x00 0x00 0x20>;
			interrupt-controller;
			#interrupt-cells = <0x02>;
			phandle = <0x3e>;
		};

		gpio1: gpio@ffaf0000 {
			compatible = "rockchip,gpio-bank";
			reg = <0x00 0xffaf0000 0x00 0x200>;
			interrupts = <0x00 0x49 0x04>;
			clocks = <&cru 0xa8 &cru 0xa9>;
			gpio-controller;
			#gpio-cells = <0x02>;
			gpio-ranges = <&pinctrl 0x00 0x20 0x20>;
			interrupt-controller;
			#interrupt-cells = <0x02>;
			phandle = <0xa7>;
		};

		gpio2: gpio@ffb00000 {
			compatible = "rockchip,gpio-bank";
			reg = <0x00 0xffb00000 0x00 0x200>;
			interrupts = <0x00 0x4b 0x04>;
			clocks = <&cru 0x194 &cru 0x195>;
			gpio-controller;
			#gpio-cells = <0x02>;
			gpio-ranges = <&pinctrl 0x00 0x40 0x20>;
			interrupt-controller;
			#interrupt-cells = <0x02>;
			phandle = <0x119>;
		};

		gpio3: gpio@ffb10000 {
			compatible = "rockchip,gpio-bank";
			reg = <0x00 0xffb10000 0x00 0x200>;
			interrupts = <0x00 0x4c 0x04>;
			clocks = <&cru 0xba &cru 0xbb>;
			gpio-controller;
			#gpio-cells = <0x02>;
			gpio-ranges = <&pinctrl 0x00 0x60 0x20>;
			interrupt-controller;
			#interrupt-cells = <0x02>;
			phandle = <0xa6>;
		};

		gpio4: gpio@ffb20000 {
			compatible = "rockchip,gpio-bank";
			reg = <0x00 0xffb20000 0x00 0x200>;
			interrupts = <0x00 0x4e 0x04>;
			clocks = <&cru 0x12c &cru 0x12d>;
			gpio-controller;
			#gpio-cells = <0x02>;
			gpio-ranges = <&pinctrl 0x00 0x80 0x20>;
			interrupt-controller;
			#interrupt-cells = <0x02>;
			phandle = <0x9e>;
		};

		pcfg_pull_up: pcfg-pull-up {
			bias-pull-up;
			phandle = <0x8e>;
		};

		pcfg_pull_down: pcfg-pull-down {
			bias-pull-down;
			phandle = <0x8f>;
		};

		pcfg_pull_none: pcfg-pull-none {
			bias-disable;
			phandle = <0x88>;
		};

		pcfg_pull_none_drv_level_0: pcfg-pull-none-drv-level-0 {
			bias-disable;
			drive-strength = <0x00>;
			phandle = <0x8d>;
		};

		pcfg_pull_none_drv_level_1: pcfg-pull-none-drv-level-1 {
			bias-disable;
			drive-strength = <0x01>;
			phandle = <0x11a>;
		};

		pcfg_pull_none_drv_level_2: pcfg-pull-none-drv-level-2 {
			bias-disable;
			drive-strength = <0x02>;
			phandle = <0x8a>;
		};

		pcfg_pull_none_drv_level_3: pcfg-pull-none-drv-level-3 {
			bias-disable;
			drive-strength = <0x03>;
			phandle = <0x11b>;
		};

		pcfg_pull_none_drv_level_4: pcfg-pull-none-drv-level-4 {
			bias-disable;
			drive-strength = <0x04>;
			phandle = <0x11c>;
		};

		pcfg_pull_none_drv_level_5: pcfg-pull-none-drv-level-5 {
			bias-disable;
			drive-strength = <0x05>;
			phandle = <0x11d>;
		};

		pcfg_pull_none_drv_level_6: pcfg-pull-none-drv-level-6 {
			bias-disable;
			drive-strength = <0x06>;
			phandle = <0x11e>;
		};

		pcfg_pull_none_drv_level_7: pcfg-pull-none-drv-level-7 {
			bias-disable;
			drive-strength = <0x07>;
			phandle = <0x11f>;
		};

		pcfg_pull_none_drv_level_8: pcfg-pull-none-drv-level-8 {
			bias-disable;
			drive-strength = <0x08>;
			phandle = <0x120>;
		};

		pcfg_pull_none_drv_level_9: pcfg-pull-none-drv-level-9 {
			bias-disable;
			drive-strength = <0x09>;
			phandle = <0x121>;
		};

		pcfg_pull_none_drv_level_10: pcfg-pull-none-drv-level-10 {
			bias-disable;
			drive-strength = <0x0a>;
			phandle = <0x122>;
		};

		pcfg_pull_none_drv_level_11: pcfg-pull-none-drv-level-11 {
			bias-disable;
			drive-strength = <0x0b>;
			phandle = <0x123>;
		};

		pcfg_pull_none_drv_level_12: pcfg-pull-none-drv-level-12 {
			bias-disable;
			drive-strength = <0x0c>;
			phandle = <0x124>;
		};

		pcfg_pull_none_drv_level_13: pcfg-pull-none-drv-level-13 {
			bias-disable;
			drive-strength = <0x0d>;
			phandle = <0x125>;
		};

		pcfg_pull_none_drv_level_14: pcfg-pull-none-drv-level-14 {
			bias-disable;
			drive-strength = <0x0e>;
			phandle = <0x126>;
		};

		pcfg_pull_none_drv_level_15: pcfg-pull-none-drv-level-15 {
			bias-disable;
			drive-strength = <0x0f>;
			phandle = <0x127>;
		};

		pcfg_pull_up_drv_level_0: pcfg-pull-up-drv-level-0 {
			bias-pull-up;
			drive-strength = <0x00>;
			phandle = <0x128>;
		};

		pcfg_pull_up_drv_level_1: pcfg-pull-up-drv-level-1 {
			bias-pull-up;
			drive-strength = <0x01>;
			phandle = <0x129>;
		};

		pcfg_pull_up_drv_level_2: pcfg-pull-up-drv-level-2 {
			bias-pull-up;
			drive-strength = <0x02>;
			phandle = <0x89>;
		};

		pcfg_pull_up_drv_level_3: pcfg-pull-up-drv-level-3 {
			bias-pull-up;
			drive-strength = <0x03>;
			phandle = <0x12a>;
		};

		pcfg_pull_up_drv_level_4: pcfg-pull-up-drv-level-4 {
			bias-pull-up;
			drive-strength = <0x04>;
			phandle = <0x12b>;
		};

		pcfg_pull_up_drv_level_5: pcfg-pull-up-drv-level-5 {
			bias-pull-up;
			drive-strength = <0x05>;
			phandle = <0x12c>;
		};

		pcfg_pull_up_drv_level_6: pcfg-pull-up-drv-level-6 {
			bias-pull-up;
			drive-strength = <0x06>;
			phandle = <0x12d>;
		};

		pcfg_pull_up_drv_level_7: pcfg-pull-up-drv-level-7 {
			bias-pull-up;
			drive-strength = <0x07>;
			phandle = <0x12e>;
		};

		pcfg_pull_up_drv_level_8: pcfg-pull-up-drv-level-8 {
			bias-pull-up;
			drive-strength = <0x08>;
			phandle = <0x12f>;
		};

		pcfg_pull_up_drv_level_9: pcfg-pull-up-drv-level-9 {
			bias-pull-up;
			drive-strength = <0x09>;
			phandle = <0x130>;
		};

		pcfg_pull_up_drv_level_10: pcfg-pull-up-drv-level-10 {
			bias-pull-up;
			drive-strength = <0x0a>;
			phandle = <0x131>;
		};

		pcfg_pull_up_drv_level_11: pcfg-pull-up-drv-level-11 {
			bias-pull-up;
			drive-strength = <0x0b>;
			phandle = <0x132>;
		};

		pcfg_pull_up_drv_level_12: pcfg-pull-up-drv-level-12 {
			bias-pull-up;
			drive-strength = <0x0c>;
			phandle = <0x133>;
		};

		pcfg_pull_up_drv_level_13: pcfg-pull-up-drv-level-13 {
			bias-pull-up;
			drive-strength = <0x0d>;
			phandle = <0x134>;
		};

		pcfg_pull_up_drv_level_14: pcfg-pull-up-drv-level-14 {
			bias-pull-up;
			drive-strength = <0x0e>;
			phandle = <0x135>;
		};

		pcfg_pull_up_drv_level_15: pcfg-pull-up-drv-level-15 {
			bias-pull-up;
			drive-strength = <0x0f>;
			phandle = <0x136>;
		};

		pcfg_pull_down_drv_level_0: pcfg-pull-down-drv-level-0 {
			bias-pull-down;
			drive-strength = <0x00>;
			phandle = <0x137>;
		};

		pcfg_pull_down_drv_level_1: pcfg-pull-down-drv-level-1 {
			bias-pull-down;
			drive-strength = <0x01>;
			phandle = <0x138>;
		};

		pcfg_pull_down_drv_level_2: pcfg-pull-down-drv-level-2 {
			bias-pull-down;
			drive-strength = <0x02>;
			phandle = <0x139>;
		};

		pcfg_pull_down_drv_level_3: pcfg-pull-down-drv-level-3 {
			bias-pull-down;
			drive-strength = <0x03>;
			phandle = <0x13a>;
		};

		pcfg_pull_down_drv_level_4: pcfg-pull-down-drv-level-4 {
			bias-pull-down;
			drive-strength = <0x04>;
			phandle = <0x13b>;
		};

		pcfg_pull_down_drv_level_5: pcfg-pull-down-drv-level-5 {
			bias-pull-down;
			drive-strength = <0x05>;
			phandle = <0x13c>;
		};

		pcfg_pull_down_drv_level_6: pcfg-pull-down-drv-level-6 {
			bias-pull-down;
			drive-strength = <0x06>;
			phandle = <0x13d>;
		};

		pcfg_pull_down_drv_level_7: pcfg-pull-down-drv-level-7 {
			bias-pull-down;
			drive-strength = <0x07>;
			phandle = <0x13e>;
		};

		pcfg_pull_down_drv_level_8: pcfg-pull-down-drv-level-8 {
			bias-pull-down;
			drive-strength = <0x08>;
			phandle = <0x13f>;
		};

		pcfg_pull_down_drv_level_9: pcfg-pull-down-drv-level-9 {
			bias-pull-down;
			drive-strength = <0x09>;
			phandle = <0x140>;
		};

		pcfg_pull_down_drv_level_10: pcfg-pull-down-drv-level-10 {
			bias-pull-down;
			drive-strength = <0x0a>;
			phandle = <0x141>;
		};

		pcfg_pull_down_drv_level_11: pcfg-pull-down-drv-level-11 {
			bias-pull-down;
			drive-strength = <0x0b>;
			phandle = <0x142>;
		};

		pcfg_pull_down_drv_level_12: pcfg-pull-down-drv-level-12 {
			bias-pull-down;
			drive-strength = <0x0c>;
			phandle = <0x143>;
		};

		pcfg_pull_down_drv_level_13: pcfg-pull-down-drv-level-13 {
			bias-pull-down;
			drive-strength = <0x0d>;
			phandle = <0x144>;
		};

		pcfg_pull_down_drv_level_14: pcfg-pull-down-drv-level-14 {
			bias-pull-down;
			drive-strength = <0x0e>;
			phandle = <0x145>;
		};

		pcfg_pull_down_drv_level_15: pcfg-pull-down-drv-level-15 {
			bias-pull-down;
			drive-strength = <0x0f>;
			phandle = <0x146>;
		};

		pcfg_pull_up_smt: pcfg-pull-up-smt {
			bias-pull-up;
			input-schmitt-enable;
			phandle = <0x147>;
		};

		pcfg_pull_down_smt: pcfg-pull-down-smt {
			bias-pull-down;
			input-schmitt-enable;
			phandle = <0x148>;
		};

		pcfg_pull_none_smt: pcfg-pull-none-smt {
			bias-disable;
			input-schmitt-enable;
			phandle = <0x8c>;
		};

		pcfg_pull_none_drv_level_0_smt: pcfg-pull-none-drv-level-0-smt {
			bias-disable;
			drive-strength = <0x00>;
			input-schmitt-enable;
			phandle = <0x149>;
		};

		pcfg_pull_none_drv_level_1_smt: pcfg-pull-none-drv-level-1-smt {
			bias-disable;
			drive-strength = <0x01>;
			input-schmitt-enable;
			phandle = <0x14a>;
		};

		pcfg_pull_none_drv_level_2_smt: pcfg-pull-none-drv-level-2-smt {
			bias-disable;
			drive-strength = <0x02>;
			input-schmitt-enable;
			phandle = <0x14b>;
		};

		pcfg_pull_none_drv_level_3_smt: pcfg-pull-none-drv-level-3-smt {
			bias-disable;
			drive-strength = <0x03>;
			input-schmitt-enable;
			phandle = <0x14c>;
		};

		pcfg_pull_none_drv_level_4_smt: pcfg-pull-none-drv-level-4-smt {
			bias-disable;
			drive-strength = <0x04>;
			input-schmitt-enable;
			phandle = <0x14d>;
		};

		pcfg_pull_none_drv_level_5_smt: pcfg-pull-none-drv-level-5-smt {
			bias-disable;
			drive-strength = <0x05>;
			input-schmitt-enable;
			phandle = <0x14e>;
		};

		pcfg_output_high: pcfg-output-high {
			output-high;
			phandle = <0x14f>;
		};

		pcfg_output_high_pull_up: pcfg-output-high-pull-up {
			output-high;
			bias-pull-up;
			phandle = <0x150>;
		};

		pcfg_output_high_pull_down: pcfg-output-high-pull-down {
			output-high;
			bias-pull-down;
			phandle = <0x151>;
		};

		pcfg_output_high_pull_none: pcfg-output-high-pull-none {
			output-high;
			bias-disable;
			phandle = <0x152>;
		};

		pcfg_output_low: pcfg-output-low {
			output-low;
			phandle = <0x153>;
		};

		pcfg_output_low_pull_up: pcfg-output-low-pull-up {
			output-low;
			bias-pull-up;
			phandle = <0x154>;
		};

		pcfg_output_low_pull_down: pcfg-output-low-pull-down {
			output-low;
			bias-pull-down;
			phandle = <0x8b>;
		};

		pcfg_output_low_pull_none: pcfg-output-low-pull-none {
			output-low;
			bias-disable;
			phandle = <0x155>;
		};

		arm {

			arm_pins: arm-pins {
				rockchip,pins = <0x04 0x14 0x03 &pcfg_pull_none>;
				phandle = <0x156>;
			};
		};

		clk {

			clkm0_32k_out: clkm0-32k-out {
				rockchip,pins = <0x03 0x13 0x03 &pcfg_pull_none>;
				phandle = <0x157>;
			};

			clkm1_32k_out: clkm1-32k-out {
				rockchip,pins = <0x01 0x13 0x01 &pcfg_pull_none>;
				phandle = <0xa5>;
			};
		};

		emmc {

			emmc_rstnout: emmc-rstnout {
				rockchip,pins = <0x01 0x1e 0x01 &pcfg_pull_none>;
				phandle = <0x158>;
			};

			emmc_bus8: emmc-bus8 {
				rockchip,pins = <0x01 0x14 0x01 &pcfg_pull_up_drv_level_2 0x01 0x15 0x01 &pcfg_pull_up_drv_level_2 0x01 0x16 0x01 &pcfg_pull_up_drv_level_2 0x01 0x17 0x01 &pcfg_pull_up_drv_level_2 0x01 0x18 0x01 &pcfg_pull_up_drv_level_2 0x01 0x19 0x01 &pcfg_pull_up_drv_level_2 0x01 0x1a 0x01 &pcfg_pull_up_drv_level_2 0x01 0x1b 0x01 &pcfg_pull_up_drv_level_2>;
				phandle = <0x159>;
			};

			emmc_clk: emmc-clk {
				rockchip,pins = <0x01 0x1d 0x01 &pcfg_pull_up_drv_level_2>;
				phandle = <0x15a>;
			};

			emmc_cmd: emmc-cmd {
				rockchip,pins = <0x01 0x1c 0x01 &pcfg_pull_up_drv_level_2>;
				phandle = <0x15b>;
			};

			emmc_strb: emmc-strb {
				rockchip,pins = <0x01 0x1f 0x01 &pcfg_pull_none>;
				phandle = <0x15c>;
			};
		};

		eth {

			eth_pins: eth-pins {
				rockchip,pins = <0x03 0x0d 0x02 &pcfg_pull_none_drv_level_2>;
				phandle = <0x15d>;
			};
		};

		fephy {

			fephym0_led_dpx: fephym0-led_dpx {
				rockchip,pins = <0x04 0x0d 0x02 &pcfg_pull_none>;
				phandle = <0x15e>;
			};

			fephym0_led_link: fephym0-led_link {
				rockchip,pins = <0x04 0x10 0x02 &pcfg_pull_none>;
				phandle = <0x75>;
			};

			fephym0_led_spd: fephym0-led_spd {
				rockchip,pins = <0x04 0x0f 0x02 &pcfg_pull_none>;
				phandle = <0x76>;
			};

			fephym1_led_dpx: fephym1-led_dpx {
				rockchip,pins = <0x02 0x04 0x05 &pcfg_pull_none>;
				phandle = <0x15f>;
			};

			fephym1_led_link: fephym1-led_link {
				rockchip,pins = <0x02 0x06 0x05 &pcfg_pull_none>;
				phandle = <0x160>;
			};

			fephym1_led_spd: fephym1-led_spd {
				rockchip,pins = <0x02 0x05 0x05 &pcfg_pull_none>;
				phandle = <0x161>;
			};
		};

		fspi {

			fspi_pins: fspi-pins {
				rockchip,pins = <0x01 0x1d 0x02 &pcfg_pull_none 0x01 0x14 0x02 &pcfg_pull_none 0x01 0x15 0x02 &pcfg_pull_none 0x01 0x16 0x02 &pcfg_pull_none 0x01 0x17 0x02 &pcfg_pull_none>;
				phandle = <0x162>;
			};

			fspi_csn0: fspi-csn0 {
				rockchip,pins = <0x01 0x18 0x02 &pcfg_pull_none>;
				phandle = <0x163>;
			};

			fspi_csn1: fspi-csn1 {
				rockchip,pins = <0x01 0x19 0x02 &pcfg_pull_none>;
				phandle = <0x164>;
			};
		};

		gpu {

			gpu_pins: gpu-pins {
				rockchip,pins = <0x04 0x13 0x03 &pcfg_pull_none>;
				phandle = <0x165>;
			};
		};

		hdmi {

			hdmi_pins: hdmi-pins {
				rockchip,pins = <0x00 0x03 0x01 &pcfg_pull_none 0x00 0x04 0x01 &pcfg_pull_none 0x00 0x05 0x01 &pcfg_pull_none>;
				phandle = <0x3c>;
			};

			hdmi_pins_idle: hdmi-pins-idle {
				rockchip,pins = <0x00 0x03 0x01 &pcfg_pull_none 0x00 0x04 0x00 &pcfg_output_low_pull_down 0x00 0x05 0x00 &pcfg_output_low_pull_down>;
				phandle = <0x166>;
			};
		};

		hsm {

			hsmm0_pins: hsmm0-pins {
				rockchip,pins = <0x02 0x02 0x04 &pcfg_pull_none>;
				phandle = <0x167>;
			};

			hsmm1_pins: hsmm1-pins {
				rockchip,pins = <0x01 0x04 0x03 &pcfg_pull_none>;
				phandle = <0x168>;
			};
		};

		i2c0 {

			i2c0m0_xfer: i2c0m0-xfer {
				rockchip,pins = <0x04 0x14 0x02 &pcfg_pull_none_smt 0x04 0x13 0x02 &pcfg_pull_none_smt>;
				phandle = <0x48>;
			};

			i2c0m1_xfer: i2c0m1-xfer {
				rockchip,pins = <0x04 0x01 0x02 &pcfg_pull_none_smt 0x04 0x00 0x02 &pcfg_pull_none_smt>;
				phandle = <0x169>;
			};
		};

		i2c1 {

			i2c1m0_xfer: i2c1m0-xfer {
				rockchip,pins = <0x04 0x03 0x02 &pcfg_pull_none_smt 0x04 0x02 0x02 &pcfg_pull_none_smt>;
				phandle = <0x49>;
			};

			i2c1m1_xfer: i2c1m1-xfer {
				rockchip,pins = <0x04 0x15 0x04 &pcfg_pull_none_smt 0x04 0x16 0x04 &pcfg_pull_none_smt>;
				phandle = <0x16a>;
			};
		};

		i2c2 {

			i2c2m0_xfer: i2c2m0-xfer {
				rockchip,pins = <0x00 0x04 0x02 &pcfg_pull_none_smt 0x00 0x05 0x02 &pcfg_pull_none_smt>;
				phandle = <0x4a>;
			};

			i2c2m1_xfer: i2c2m1-xfer {
				rockchip,pins = <0x01 0x05 0x03 &pcfg_pull_none_smt 0x01 0x06 0x03 &pcfg_pull_none_smt>;
				phandle = <0x16b>;
			};
		};

		i2c3 {

			i2c3m0_xfer: i2c3m0-xfer {
				rockchip,pins = <0x01 0x00 0x02 &pcfg_pull_none_smt 0x01 0x01 0x02 &pcfg_pull_none_smt>;
				phandle = <0x4b>;
			};

			i2c3m1_xfer: i2c3m1-xfer {
				rockchip,pins = <0x03 0x11 0x05 &pcfg_pull_none_smt 0x03 0x13 0x05 &pcfg_pull_none_smt>;
				phandle = <0x16c>;
			};
		};

		i2c4 {

			i2c4_xfer: i2c4-xfer {
				rockchip,pins = <0x02 0x00 0x04 &pcfg_pull_none_smt 0x02 0x01 0x04 &pcfg_pull_none_smt>;
				phandle = <0x4c>;
			};
		};

		i2c5 {

			i2c5m0_xfer: i2c5m0-xfer {
				rockchip,pins = <0x01 0x0a 0x03 &pcfg_pull_none_smt 0x01 0x0b 0x03 &pcfg_pull_none_smt>;
				phandle = <0x4d>;
			};

			i2c5m1_xfer: i2c5m1-xfer {
				rockchip,pins = <0x01 0x1a 0x03 &pcfg_pull_none_smt 0x01 0x1b 0x03 &pcfg_pull_none_smt>;
				phandle = <0x16d>;
			};
		};

		i2c6 {

			i2c6m0_xfer: i2c6m0-xfer {
				rockchip,pins = <0x03 0x0a 0x05 &pcfg_pull_none_smt 0x03 0x0b 0x05 &pcfg_pull_none_smt>;
				phandle = <0x4e>;
			};

			i2c6m1_xfer: i2c6m1-xfer {
				rockchip,pins = <0x01 0x1c 0x03 &pcfg_pull_none_smt 0x01 0x1f 0x03 &pcfg_pull_none_smt>;
				phandle = <0x16e>;
			};
		};

		i2c7 {

			i2c7_xfer: i2c7-xfer {
				rockchip,pins = <0x02 0x05 0x04 &pcfg_pull_none_smt 0x02 0x06 0x04 &pcfg_pull_none_smt>;
				phandle = <0x4f>;
			};
		};

		i2s0 {

			i2s0m0_lrck: i2s0m0-lrck {
				rockchip,pins = <0x03 0x0e 0x01 &pcfg_pull_none_smt>;
				phandle = <0x5b>;
			};

			i2s0m0_mclk: i2s0m0-mclk {
				rockchip,pins = <0x03 0x0c 0x01 &pcfg_pull_none_smt>;
				phandle = <0x16f>;
			};

			i2s0m0_sclk: i2s0m0-sclk {
				rockchip,pins = <0x03 0x0d 0x01 &pcfg_pull_none_smt>;
				phandle = <0x5c>;
			};

			i2s0m0_sdi: i2s0m0-sdi {
				rockchip,pins = <0x03 0x0f 0x01 &pcfg_pull_none>;
				phandle = <0x5d>;
			};

			i2s0m0_sdo: i2s0m0-sdo {
				rockchip,pins = <0x03 0x10 0x01 &pcfg_pull_none>;
				phandle = <0x5e>;
			};

			i2s0m1_lrck: i2s0m1-lrck {
				rockchip,pins = <0x01 0x0e 0x01 &pcfg_pull_none_smt>;
				phandle = <0x170>;
			};

			i2s0m1_mclk: i2s0m1-mclk {
				rockchip,pins = <0x01 0x0c 0x01 &pcfg_pull_none_smt>;
				phandle = <0x171>;
			};

			i2s0m1_sclk: i2s0m1-sclk {
				rockchip,pins = <0x01 0x0d 0x01 &pcfg_pull_none_smt>;
				phandle = <0x172>;
			};

			i2s0m1_sdi: i2s0m1-sdi {
				rockchip,pins = <0x01 0x0f 0x01 &pcfg_pull_none>;
				phandle = <0x173>;
			};

			i2s0m1_sdo: i2s0m1-sdo {
				rockchip,pins = <0x01 0x10 0x01 &pcfg_pull_none>;
				phandle = <0x174>;
			};
		};

		i2s1 {

			i2s1_lrck: i2s1-lrck {
				rockchip,pins = <0x04 0x06 0x01 &pcfg_pull_none_smt>;
				phandle = <0x60>;
			};

			i2s1_mclk: i2s1-mclk {
				rockchip,pins = <0x04 0x04 0x01 &pcfg_pull_none_smt>;
				phandle = <0x175>;
			};

			i2s1_sclk: i2s1-sclk {
				rockchip,pins = <0x04 0x05 0x01 &pcfg_pull_none_smt>;
				phandle = <0x5f>;
			};

			i2s1_sdi0: i2s1-sdi0 {
				rockchip,pins = <0x04 0x0c 0x01 &pcfg_pull_none>;
				phandle = <0x61>;
			};

			i2s1_sdi1: i2s1-sdi1 {
				rockchip,pins = <0x04 0x0b 0x01 &pcfg_pull_none>;
				phandle = <0x62>;
			};

			i2s1_sdi2: i2s1-sdi2 {
				rockchip,pins = <0x04 0x03 0x01 &pcfg_pull_none>;
				phandle = <0x63>;
			};

			i2s1_sdi3: i2s1-sdi3 {
				rockchip,pins = <0x04 0x02 0x01 &pcfg_pull_none>;
				phandle = <0x64>;
			};

			i2s1_sdo0: i2s1-sdo0 {
				rockchip,pins = <0x04 0x07 0x01 &pcfg_pull_none>;
				phandle = <0x65>;
			};

			i2s1_sdo1: i2s1-sdo1 {
				rockchip,pins = <0x04 0x08 0x01 &pcfg_pull_none>;
				phandle = <0x66>;
			};

			i2s1_sdo2: i2s1-sdo2 {
				rockchip,pins = <0x04 0x09 0x01 &pcfg_pull_none>;
				phandle = <0x67>;
			};

			i2s1_sdo3: i2s1-sdo3 {
				rockchip,pins = <0x04 0x0a 0x01 &pcfg_pull_none>;
				phandle = <0x68>;
			};
		};

		jtag {

			jtagm0_pins: jtagm0-pins {
				rockchip,pins = <0x02 0x02 0x02 &pcfg_pull_none 0x02 0x03 0x02 &pcfg_pull_none 0x02 0x04 0x02 &pcfg_pull_none 0x02 0x05 0x02 &pcfg_pull_none>;
				phandle = <0x176>;
			};

			jtagm1_pins: jtagm1-pins {
				rockchip,pins = <0x04 0x18 0x02 &pcfg_pull_none 0x04 0x17 0x02 &pcfg_pull_none 0x04 0x18 0x03 &pcfg_pull_none 0x04 0x17 0x03 &pcfg_pull_none>;
				phandle = <0x177>;
			};
		};

		pcie {

			pciem0_pins: pciem0-pins {
				rockchip,pins = <0x03 0x06 0x05 &pcfg_pull_none 0x03 0x08 0x05 &pcfg_pull_none 0x03 0x07 0x05 &pcfg_pull_none>;
				phandle = <0x178>;
			};

			pciem1_pins: pciem1-pins {
				rockchip,pins = <0x01 0x00 0x04 &pcfg_pull_none 0x01 0x02 0x04 &pcfg_pull_none 0x01 0x01 0x04 &pcfg_pull_none>;
				phandle = <0x179>;
			};
		};

		pdm {

			pdm_clk0: pdm-clk0 {
				rockchip,pins = <0x04 0x0d 0x03 &pcfg_pull_none>;
				phandle = <0x69>;
			};

			pdm_clk1: pdm-clk1 {
				rockchip,pins = <0x04 0x04 0x03 &pcfg_pull_none>;
				phandle = <0x6a>;
			};

			pdm_sdi0: pdm-sdi0 {
				rockchip,pins = <0x04 0x0a 0x03 &pcfg_pull_none>;
				phandle = <0x6b>;
			};

			pdm_sdi1: pdm-sdi1 {
				rockchip,pins = <0x04 0x09 0x03 &pcfg_pull_none>;
				phandle = <0x6c>;
			};

			pdm_sdi2: pdm-sdi2 {
				rockchip,pins = <0x04 0x0b 0x03 &pcfg_pull_none>;
				phandle = <0x6d>;
			};

			pdm_sdi3: pdm-sdi3 {
				rockchip,pins = <0x04 0x11 0x03 &pcfg_pull_none>;
				phandle = <0x6e>;
			};
		};

		pmu {

			pmu_pins: pmu-pins {
				rockchip,pins = <0x04 0x00 0x04 &pcfg_pull_none>;
				phandle = <0x17a>;
			};
		};

		pwm0 {

			pwm0m0_pins: pwm0m0-pins {
				rockchip,pins = <0x04 0x13 0x01 &pcfg_pull_none_drv_level_0>;
				phandle = <0x50>;
			};

			pwm0m1_pins: pwm0m1-pins {
				rockchip,pins = <0x01 0x02 0x05 &pcfg_pull_none_drv_level_0>;
				phandle = <0x17b>;
			};
		};

		pwm1 {

			pwm1m0_pins: pwm1m0-pins {
				rockchip,pins = <0x04 0x14 0x01 &pcfg_pull_none_drv_level_0>;
				phandle = <0x51>;
			};

			pwm1m1_pins: pwm1m1-pins {
				rockchip,pins = <0x01 0x03 0x04 &pcfg_pull_none_drv_level_0>;
				phandle = <0x17c>;
			};
		};

		pwm2 {

			pwm2m0_pins: pwm2m0-pins {
				rockchip,pins = <0x04 0x15 0x01 &pcfg_pull_none_drv_level_0>;
				phandle = <0x52>;
			};

			pwm2m1_pins: pwm2m1-pins {
				rockchip,pins = <0x01 0x07 0x02 &pcfg_pull_none_drv_level_0>;
				phandle = <0x17d>;
			};
		};

		pwm3 {

			pwm3m0_pins: pwm3m0-pins {
				rockchip,pins = <0x04 0x16 0x01 &pcfg_pull_none_drv_level_0>;
				phandle = <0x53>;
			};

			pwm3m1_pins: pwm3m1-pins {
				rockchip,pins = <0x02 0x04 0x03 &pcfg_pull_none_drv_level_0>;
				phandle = <0x17e>;
			};
		};

		pwm4 {

			pwm4m0_pins: pwm4m0-pins {
				rockchip,pins = <0x04 0x0f 0x01 &pcfg_pull_none_drv_level_0>;
				phandle = <0x54>;
			};

			pwm4m1_pins: pwm4m1-pins {
				rockchip,pins = <0x01 0x04 0x02 &pcfg_pull_none_drv_level_0>;
				phandle = <0x17f>;
			};
		};

		pwm5 {

			pwm5m0_pins: pwm5m0-pins {
				rockchip,pins = <0x04 0x10 0x01 &pcfg_pull_none_drv_level_0>;
				phandle = <0x55>;
			};

			pwm5m1_pins: pwm5m1-pins {
				rockchip,pins = <0x03 0x13 0x01 &pcfg_pull_none_drv_level_0>;
				phandle = <0x180>;
			};
		};

		pwm6 {

			pwm6m0_pins: pwm6m0-pins {
				rockchip,pins = <0x04 0x11 0x01 &pcfg_pull_none_drv_level_0>;
				phandle = <0x56>;
			};

			pwm6m1_pins: pwm6m1-pins {
				rockchip,pins = <0x01 0x13 0x03 &pcfg_pull_none_drv_level_0>;
				phandle = <0x181>;
			};

			pwm6m2_pins: pwm6m2-pins {
				rockchip,pins = <0x03 0x11 0x01 &pcfg_pull_none_drv_level_0>;
				phandle = <0x182>;
			};
		};

		pwm7 {

			pwm7m0_pins: pwm7m0-pins {
				rockchip,pins = <0x04 0x12 0x01 &pcfg_pull_none_drv_level_0>;
				phandle = <0x57>;
			};

			pwm7m1_pins: pwm7m1-pins {
				rockchip,pins = <0x01 0x12 0x02 &pcfg_pull_none_drv_level_0>;
				phandle = <0x183>;
			};
		};

		pwr {

			pwr_pins: pwr-pins {
				rockchip,pins = <0x04 0x12 0x02 &pcfg_pull_none 0x04 0x0e 0x01 &pcfg_pull_none>;
				phandle = <0x184>;
			};
		};

		ref {

			refm0_pins: refm0-pins {
				rockchip,pins = <0x00 0x01 0x01 &pcfg_pull_none>;
				phandle = <0x185>;
			};

			refm1_pins: refm1-pins {
				rockchip,pins = <0x03 0x13 0x06 &pcfg_pull_none>;
				phandle = <0x186>;
			};
		};

		rgmii {

			rgmii_miim: rgmii-miim {
				rockchip,pins = <0x03 0x0e 0x02 &pcfg_pull_none_drv_level_2 0x03 0x0f 0x02 &pcfg_pull_none_drv_level_2>;
				phandle = <0x187>;
			};

			rgmii_rx_bus2: rgmii-rx_bus2 {
				rockchip,pins = <0x03 0x03 0x02 &pcfg_pull_none 0x03 0x02 0x02 &pcfg_pull_none 0x03 0x12 0x02 &pcfg_pull_none>;
				phandle = <0x188>;
			};

			rgmii_tx_bus2: rgmii-tx_bus2 {
				rockchip,pins = <0x03 0x01 0x02 &pcfg_pull_none_drv_level_2 0x03 0x00 0x02 &pcfg_pull_none_drv_level_2 0x03 0x10 0x02 &pcfg_pull_none>;
				phandle = <0x189>;
			};

			rgmii_rgmii_clk: rgmii-rgmii_clk {
				rockchip,pins = <0x03 0x05 0x02 &pcfg_pull_none 0x03 0x04 0x02 &pcfg_pull_none_drv_level_2>;
				phandle = <0x18a>;
			};

			rgmii_rgmii_bus: rgmii-rgmii_bus {
				rockchip,pins = <0x03 0x07 0x02 &pcfg_pull_none 0x03 0x06 0x02 &pcfg_pull_none 0x03 0x09 0x02 &pcfg_pull_none_drv_level_2 0x03 0x08 0x02 &pcfg_pull_none_drv_level_2>;
				phandle = <0x18b>;
			};

			rgmii_clk: rgmii-clk {
				rockchip,pins = <0x03 0x0c 0x02 &pcfg_pull_none>;
				phandle = <0x18c>;
			};

			rgmii_txer: rgmii-txer {
				rockchip,pins = <0x03 0x11 0x02 &pcfg_pull_none>;
				phandle = <0x18d>;
			};
		};

		scr {

			scrm0_pins: scrm0-pins {
				rockchip,pins = <0x01 0x02 0x03 &pcfg_pull_none 0x01 0x01 0x03 &pcfg_pull_none 0x01 0x00 0x03 &pcfg_pull_none 0x01 0x03 0x03 &pcfg_pull_none>;
				phandle = <0x18e>;
			};

			scrm1_pins: scrm1-pins {
				rockchip,pins = <0x02 0x05 0x03 &pcfg_pull_none 0x02 0x03 0x04 &pcfg_pull_none 0x02 0x06 0x03 &pcfg_pull_none 0x02 0x04 0x04 &pcfg_pull_none>;
				phandle = <0x18f>;
			};
		};

		sdio0 {

			sdio0_bus4: sdio0-bus4 {
				rockchip,pins = <0x01 0x00 0x01 &pcfg_pull_up_drv_level_2 0x01 0x01 0x01 &pcfg_pull_up_drv_level_2 0x01 0x02 0x01 &pcfg_pull_up_drv_level_2 0x01 0x03 0x01 &pcfg_pull_up_drv_level_2>;
				phandle = <0x190>;
			};

			sdio0_clk: sdio0-clk {
				rockchip,pins = <0x01 0x05 0x01 &pcfg_pull_up_drv_level_2>;
				phandle = <0x191>;
			};

			sdio0_cmd: sdio0-cmd {
				rockchip,pins = <0x01 0x04 0x01 &pcfg_pull_up_drv_level_2>;
				phandle = <0x192>;
			};

			sdio0_det: sdio0-det {
				rockchip,pins = <0x01 0x06 0x01 &pcfg_pull_up>;
				phandle = <0x193>;
			};

			sdio0_pwren: sdio0-pwren {
				rockchip,pins = <0x01 0x07 0x01 &pcfg_pull_none>;
				phandle = <0x194>;
			};
		};

		sdio1 {

			sdio1_bus4: sdio1-bus4 {
				rockchip,pins = <0x03 0x06 0x01 &pcfg_pull_up_drv_level_2 0x03 0x07 0x01 &pcfg_pull_up_drv_level_2 0x03 0x08 0x01 &pcfg_pull_up_drv_level_2 0x03 0x09 0x01 &pcfg_pull_up_drv_level_2>;
				phandle = <0x7a>;
			};

			sdio1_clk: sdio1-clk {
				rockchip,pins = <0x03 0x04 0x01 &pcfg_pull_up_drv_level_2>;
				phandle = <0x7c>;
			};

			sdio1_cmd: sdio1-cmd {
				rockchip,pins = <0x03 0x05 0x01 &pcfg_pull_up_drv_level_2>;
				phandle = <0x7b>;
			};

			sdio1_det: sdio1-det {
				rockchip,pins = <0x03 0x0b 0x01 &pcfg_pull_up>;
				phandle = <0x195>;
			};

			sdio1_pwren: sdio1-pwren {
				rockchip,pins = <0x03 0x0a 0x01 &pcfg_pull_none>;
				phandle = <0x196>;
			};
		};

		sdmmc {

			sdmmc_bus4: sdmmc-bus4 {
				rockchip,pins = <0x02 0x00 0x01 &pcfg_pull_up_drv_level_2 0x02 0x01 0x01 &pcfg_pull_up_drv_level_2 0x02 0x02 0x01 &pcfg_pull_up_drv_level_2 0x02 0x03 0x01 &pcfg_pull_up_drv_level_2>;
				phandle = <0x80>;
			};

			sdmmc_clk: sdmmc-clk {
				rockchip,pins = <0x02 0x05 0x01 &pcfg_pull_up_drv_level_2>;
				phandle = <0x7d>;
			};

			sdmmc_cmd: sdmmc-cmd {
				rockchip,pins = <0x02 0x04 0x01 &pcfg_pull_up_drv_level_2>;
				phandle = <0x7e>;
			};

			sdmmc_det: sdmmc-det {
				rockchip,pins = <0x02 0x06 0x01 &pcfg_pull_up>;
				phandle = <0x7f>;
			};

			sdmmc_pwren: sdmmc-pwren {
				rockchip,pins = <0x04 0x01 0x01 &pcfg_pull_none>;
				phandle = <0x197>;
			};
		};

		spdif {

			spdifm0_pins: spdifm0-pins {
				rockchip,pins = <0x04 0x00 0x01 &pcfg_pull_none>;
				phandle = <0x6f>;
			};

			spdifm1_pins: spdifm1-pins {
				rockchip,pins = <0x01 0x13 0x02 &pcfg_pull_none>;
				phandle = <0x198>;
			};

			spdifm2_pins: spdifm2-pins {
				rockchip,pins = <0x03 0x13 0x02 &pcfg_pull_none>;
				phandle = <0x199>;
			};
		};

		spi0 {

			spi0_pins: spi0-pins {
				rockchip,pins = <0x04 0x0c 0x02 &pcfg_pull_none_drv_level_2 0x04 0x0b 0x02 &pcfg_pull_none_drv_level_2 0x04 0x0a 0x02 &pcfg_pull_none_drv_level_2>;
				phandle = <0x42>;
			};

			spi0_csn0: spi0-csn0 {
				rockchip,pins = <0x04 0x0e 0x02 &pcfg_pull_none_drv_level_2>;
				phandle = <0x40>;
			};

			spi0_csn1: spi0-csn1 {
				rockchip,pins = <0x04 0x11 0x02 &pcfg_pull_none_drv_level_2>;
				phandle = <0x41>;
			};
		};

		spi1 {

			spi1_pins: spi1-pins {
				rockchip,pins = <0x01 0x0e 0x02 &pcfg_pull_none_drv_level_2 0x01 0x10 0x02 &pcfg_pull_none_drv_level_2 0x01 0x0f 0x02 &pcfg_pull_none_drv_level_2>;
				phandle = <0x45>;
			};

			spi1_csn0: spi1-csn0 {
				rockchip,pins = <0x01 0x11 0x01 &pcfg_pull_none_drv_level_2>;
				phandle = <0x43>;
			};

			spi1_csn1: spi1-csn1 {
				rockchip,pins = <0x01 0x12 0x01 &pcfg_pull_none_drv_level_2>;
				phandle = <0x44>;
			};
		};

		tsi0 {

			tsi0_pins: tsi0-pins {
				rockchip,pins = <0x03 0x0a 0x03 &pcfg_pull_none 0x03 0x09 0x03 &pcfg_pull_none 0x03 0x0d 0x03 &pcfg_pull_none 0x03 0x0e 0x03 &pcfg_pull_none 0x03 0x0f 0x03 &pcfg_pull_none 0x03 0x03 0x03 &pcfg_pull_none 0x03 0x02 0x03 &pcfg_pull_none 0x03 0x01 0x03 &pcfg_pull_none 0x03 0x00 0x03 &pcfg_pull_none 0x03 0x10 0x03 &pcfg_pull_none 0x03 0x0c 0x03 &pcfg_pull_none 0x03 0x0b 0x03 &pcfg_pull_none>;
				phandle = <0x19a>;
			};
		};

		tsi1 {

			tsi1_pins: tsi1-pins {
				rockchip,pins = <0x03 0x05 0x03 &pcfg_pull_none 0x03 0x04 0x03 &pcfg_pull_none 0x03 0x07 0x03 &pcfg_pull_none 0x03 0x06 0x03 &pcfg_pull_none>;
				phandle = <0x19b>;
			};
		};

		uart0 {

			uart0m0_xfer: uart0m0-xfer {
				rockchip,pins = <0x04 0x17 0x01 &pcfg_pull_up 0x04 0x18 0x01 &pcfg_pull_up>;
				phandle = <0xab>;
			};

			uart0m1_xfer: uart0m1-xfer {
				rockchip,pins = <0x02 0x00 0x02 &pcfg_pull_up 0x02 0x01 0x02 &pcfg_pull_up>;
				phandle = <0x19c>;
			};
		};

		uart1 {

			uart1m0_xfer: uart1m0-xfer {
				rockchip,pins = <0x04 0x07 0x02 &pcfg_pull_up 0x04 0x06 0x02 &pcfg_pull_up>;
				phandle = <0x19d>;
			};

			uart1m1_xfer: uart1m1-xfer {
				rockchip,pins = <0x04 0x16 0x02 &pcfg_pull_up 0x04 0x15 0x02 &pcfg_pull_up>;
				phandle = <0x19e>;
			};

			uart1_ctsn: uart1-ctsn {
				rockchip,pins = <0x04 0x04 0x02 &pcfg_pull_none>;
				phandle = <0x19f>;
			};

			uart1_rtsn: uart1-rtsn {
				rockchip,pins = <0x04 0x05 0x02 &pcfg_pull_none>;
				phandle = <0x1a0>;
			};
		};

		uart2 {

			uart2m0_xfer: uart2m0-xfer {
				rockchip,pins = <0x03 0x00 0x01 &pcfg_pull_up 0x03 0x01 0x01 &pcfg_pull_up>;
				phandle = <0x1a1>;
			};

			uart2m0_ctsn: uart2m0-ctsn {
				rockchip,pins = <0x03 0x03 0x01 &pcfg_pull_none>;
				phandle = <0x1a2>;
			};

			uart2m0_rtsn: uart2m0-rtsn {
				rockchip,pins = <0x03 0x02 0x01 &pcfg_pull_none>;
				phandle = <0x1a3>;
			};

			uart2m1_xfer: uart2m1-xfer {
				rockchip,pins = <0x01 0x08 0x01 &pcfg_pull_up 0x01 0x09 0x01 &pcfg_pull_up>;
				phandle = <0x46>;
			};

			uart2m1_ctsn: uart2m1-ctsn {
				rockchip,pins = <0x01 0x0b 0x01 &pcfg_pull_none>;
				phandle = <0x47>;
			};

			uart2m1_rtsn: uart2m1-rtsn {
				rockchip,pins = <0x01 0x0a 0x01 &pcfg_pull_none>;
				phandle = <0xa8>;
			};
		};

		uart3 {

			uart3m0_xfer: uart3m0-xfer {
				rockchip,pins = <0x04 0x08 0x02 &pcfg_pull_up 0x04 0x09 0x02 &pcfg_pull_up>;
				phandle = <0x1a4>;
			};

			uart3m1_xfer: uart3m1-xfer {
				rockchip,pins = <0x04 0x0f 0x03 &pcfg_pull_up 0x04 0x10 0x03 &pcfg_pull_up>;
				phandle = <0x1a5>;
			};

			uart3_ctsn: uart3-ctsn {
				rockchip,pins = <0x04 0x03 0x03 &pcfg_pull_none>;
				phandle = <0x1a6>;
			};

			uart3_rtsn: uart3-rtsn {
				rockchip,pins = <0x04 0x02 0x03 &pcfg_pull_none>;
				phandle = <0x1a7>;
			};
		};

		uart4 {

			uart4_xfer: uart4-xfer {
				rockchip,pins = <0x02 0x02 0x03 &pcfg_pull_up 0x02 0x03 0x03 &pcfg_pull_up>;
				phandle = <0x1a8>;
			};

			uart4_ctsn: uart4-ctsn {
				rockchip,pins = <0x02 0x01 0x03 &pcfg_pull_none>;
				phandle = <0x1a9>;
			};

			uart4_rtsn: uart4-rtsn {
				rockchip,pins = <0x02 0x00 0x03 &pcfg_pull_none>;
				phandle = <0x1aa>;
			};
		};

		uart5 {

			uart5m0_xfer: uart5m0-xfer {
				rockchip,pins = <0x01 0x02 0x02 &pcfg_pull_up 0x01 0x03 0x02 &pcfg_pull_up>;
				phandle = <0x1ab>;
			};

			uart5m0_ctsn: uart5m0-ctsn {
				rockchip,pins = <0x01 0x06 0x02 &pcfg_pull_none>;
				phandle = <0x1ac>;
			};

			uart5m0_rtsn: uart5m0-rtsn {
				rockchip,pins = <0x01 0x05 0x02 &pcfg_pull_none>;
				phandle = <0x1ad>;
			};

			uart5m1_xfer: uart5m1-xfer {
				rockchip,pins = <0x01 0x1c 0x02 &pcfg_pull_up 0x01 0x1f 0x02 &pcfg_pull_up>;
				phandle = <0x1ae>;
			};

			uart5m1_ctsn: uart5m1-ctsn {
				rockchip,pins = <0x01 0x1b 0x02 &pcfg_pull_none>;
				phandle = <0x1af>;
			};

			uart5m1_rtsn: uart5m1-rtsn {
				rockchip,pins = <0x01 0x1a 0x02 &pcfg_pull_none>;
				phandle = <0x1b0>;
			};
		};

		uart6 {

			uart6m0_xfer: uart6m0-xfer {
				rockchip,pins = <0x03 0x07 0x04 &pcfg_pull_up 0x03 0x06 0x04 &pcfg_pull_up>;
				phandle = <0x1b1>;
			};

			uart6m1_xfer: uart6m1-xfer {
				rockchip,pins = <0x03 0x13 0x04 &pcfg_pull_up 0x03 0x11 0x04 &pcfg_pull_up>;
				phandle = <0x1b2>;
			};

			uart6_ctsn: uart6-ctsn {
				rockchip,pins = <0x03 0x04 0x04 &pcfg_pull_none>;
				phandle = <0x1b3>;
			};

			uart6_rtsn: uart6-rtsn {
				rockchip,pins = <0x03 0x05 0x04 &pcfg_pull_none>;
				phandle = <0x1b4>;
			};
		};

		uart7 {

			uart7m0_xfer: uart7m0-xfer {
				rockchip,pins = <0x03 0x0b 0x04 &pcfg_pull_up 0x03 0x0a 0x04 &pcfg_pull_up>;
				phandle = <0x1b5>;
			};

			uart7m0_ctsn: uart7m0-ctsn {
				rockchip,pins = <0x03 0x08 0x04 &pcfg_pull_none>;
				phandle = <0x1b6>;
			};

			uart7m0_rtsn: uart7m0-rtsn {
				rockchip,pins = <0x03 0x09 0x04 &pcfg_pull_none>;
				phandle = <0x1b7>;
			};

			uart7m1_xfer: uart7m1-xfer {
				rockchip,pins = <0x01 0x0b 0x04 &pcfg_pull_up 0x01 0x0a 0x04 &pcfg_pull_up>;
				phandle = <0x1b8>;
			};

			uart7m1_ctsn: uart7m1-ctsn {
				rockchip,pins = <0x01 0x08 0x04 &pcfg_pull_none>;
				phandle = <0x1b9>;
			};

			uart7m1_rtsn: uart7m1-rtsn {
				rockchip,pins = <0x01 0x09 0x04 &pcfg_pull_none>;
				phandle = <0x1ba>;
			};
		};

		usb {

			vcc5v0_host_en: vcc5v0-host-en {
				rockchip,pins = <0x04 0x0d 0x00 &pcfg_pull_none>;
				phandle = <0xa0>;
			};

			vcc5v0_otg_en: vcc5v0-otg-en {
				rockchip,pins = <0x04 0x11 0x00 &pcfg_pull_none>;
				phandle = <0xa1>;
			};
		};

		sdio-pwrseq {

			wifi_enable_h: wifi-enable-h {
				rockchip,pins = <0x03 0x0a 0x00 &pcfg_pull_none>;
				phandle = <0xa4>;
			};

			wifi_32k: wifi-32k {
				rockchip,pins = <0x01 0x13 0x01 &pcfg_pull_none>;
				phandle = <0x1bb>;
			};
		};

		wireless-wlan {

			wifi_host_wake_irq: wifi-host-wake-irq {
				rockchip,pins = <0x01 0x07 0x00 &pcfg_pull_down>;
				phandle = <0xaa>;
			};
		};

		wireless-bluetooth {

			uart2m1_gpios: uart2m1-gpios {
				rockchip,pins = <0x01 0x0a 0x00 &pcfg_pull_none>;
				phandle = <0xa9>;
			};
		};
	};

	acodec_sound: acodec-sound {
		status = "okay";
		compatible = "simple-audio-card";
		simple-audio-card,name = "rk3528-acodec";
		simple-audio-card,format = "i2s";
		simple-audio-card,mclk-fs = <0x100>;
		phandle = <0x1bc>;

		simple-audio-card,cpu {
			sound-dai = <&sai2>;
		};

		simple-audio-card,codec {
			sound-dai = <&acodec>;
		};
	};

	adc_keys: adc-keys {
		status = "okay";
		compatible = "adc-keys";
		io-channels = <&saradc 0x01>;
		io-channel-names = "buttons";
		keyup-threshold-microvolt = <0x1b7740>;
		poll-interval = <0x64>;
		phandle = <0x1bd>;

		vol-up-key {
			label = "volume up";
			linux,code = <0x73>;
			press-threshold-microvolt = <0x6d6>;
		};
	};

	bt_sco: bt-sco {
		status = "disabled";
		compatible = "delta,dfbmcs320";
		#sound-dai-cells = <0x01>;
		phandle = <0x94>;
	};

	bt_sound: bt-sound {
		status = "disabled";
		compatible = "simple-audio-card";
		simple-audio-card,format = "dsp_a";
		simple-audio-card,bitclock-inversion;
		simple-audio-card,mclk-fs = <0x100>;
		simple-audio-card,name = "rockchip,bt";
		phandle = <0x1be>;

		simple-audio-card,cpu {
			sound-dai = <&sai0>;
		};

		simple-audio-card,codec {
			sound-dai = <&bt_sco 0x01>;
		};
	};

	dc_12v: dc-12v {
		compatible = "regulator-fixed";
		regulator-name = "dc_12v";
		regulator-always-on;
		regulator-boot-on;
		regulator-min-microvolt = <0xb71b00>;
		regulator-max-microvolt = <0xb71b00>;
		phandle = <0x9d>;
	};

	es7243_sound: es7243-sound {
		status = "disabled";
		compatible = "simple-audio-card";
		simple-audio-card,name = "rockchip,es7243";
		simple-audio-card,format = "i2s";
		simple-audio-card,mclk-fs = <0x100>;
		phandle = <0x1bf>;

		simple-audio-card,cpu {
			sound-dai = <&sai1>;
		};

		simple-audio-card,codec {
			sound-dai = <&es7243e>;
		};
	};

	hdmi_sound: hdmi-sound {
		compatible = "rockchip,hdmi";
		rockchip,mclk-fs = <0x80>;
		rockchip,card-name = "rockchip,hdmi";
		rockchip,cpu = <&sai3>;
		rockchip,codec = <&hdmi>;
		rockchip,jack-det;
		phandle = <0x1c0>;
	};

	pdmics: dummy-codec {
		status = "disabled";
		compatible = "rockchip,dummy-codec";
		#sound-dai-cells = <0x00>;
		phandle = <0x9a>;
	};

	pdm_mic_array: pdm-mic-array {
		status = "disabled";
		compatible = "simple-audio-card";
		simple-audio-card,name = "rockchip,pdm-mic-array";
		phandle = <0x1c1>;

		simple-audio-card,cpu {
			sound-dai = <&pdm>;
		};

		simple-audio-card,codec {
			sound-dai = <&pdmics>;
		};
	};

	spdif-sound {
		status = "okay";
		compatible = "simple-audio-card";
		simple-audio-card,name = "ROCKCHIP,SPDIF";
		simple-audio-card,mclk-fs = <0x80>;

		simple-audio-card,cpu {
			sound-dai = <&spdif_8ch>;
		};

		simple-audio-card,codec {
			sound-dai = <&spdif_out>;
		};
	};

	spdif_out: spdif-out {
		status = "okay";
		compatible = "linux,spdif-dit";
		#sound-dai-cells = <0x00>;
		phandle = <0x9c>;
	};

	vcc5v0_sys: vcc5v0-sys {
		compatible = "regulator-fixed";
		regulator-name = "vcc5v0_sys";
		regulator-always-on;
		regulator-boot-on;
		regulator-min-microvolt = <0x4c4b40>;
		regulator-max-microvolt = <0x4c4b40>;
		vin-supply = <&dc_12v>;
		phandle = <0x9f>;
	};

	vcc5v0_host: vcc5v0-host-regulator {
		compatible = "regulator-fixed";
		regulator-name = "vcc5v0_host";
		regulator-boot-on;
		regulator-always-on;
		regulator-min-microvolt = <0x4c4b40>;
		regulator-max-microvolt = <0x4c4b40>;
		enable-active-high;
		gpio = <&gpio4 0x0d 0x00>;
		vin-supply = <&vcc5v0_sys>;
		pinctrl-names = "default";
		pinctrl-0 = <&vcc5v0_host_en>;
		phandle = <0x84>;
	};

	vcc5v0_otg: vcc5v0-otg-regulator {
		compatible = "regulator-fixed";
		regulator-name = "vcc5v0_otg";
		regulator-min-microvolt = <0x4c4b40>;
		regulator-max-microvolt = <0x4c4b40>;
		enable-active-high;
		gpio = <&gpio4 0x0c 0x00>;
		vin-supply = <&vcc5v0_sys>;
		pinctrl-names = "default";
		pinctrl-0 = <&vcc5v0_otg_en>;
		phandle = <0x83>;
	};

	vccio_sd: vccio-sd {
		compatible = "regulator-gpio";
		regulator-name = "vccio_sd";
		regulator-min-microvolt = <0x1b7740>;
		regulator-max-microvolt = <0x325aa0>;
		gpios = <&gpio4 0x0e 0x00>;
		vin-supply = <&vcc5v0_sys>;
		states = <0x1b7740 0x00 0x325aa0 0x01>;
		phandle = <0x81>;
	};

	vdd_cpu: vdd_logic: vdd_gpu: vdd-cpu {
		compatible = "pwm-regulator";
		pwms = <&pwm1 0x00 0x1388 0x01>;
		regulator-name = "vdd_cpu";
		regulator-min-microvolt = <0xb6210>;
		regulator-max-microvolt = <0x125368>;
		regulator-init-microvolt = <0xe8aa8>;
		regulator-always-on;
		regulator-boot-on;
		regulator-settling-time-up-us = <0xfa>;
		pwm-supply = <&vcc5v0_sys>;
		status = "okay";
		phandle = <0x0a>;
	};

	vdd_0v9_s3: vdd-0v9-s3 {
		compatible = "regulator-fixed";
		regulator-name = "vdd_0v9_s3";
		regulator-always-on;
		regulator-boot-on;
		regulator-min-microvolt = <0xdbba0>;
		regulator-max-microvolt = <0xdbba0>;
		vin-supply = <&vcc5v0_sys>;
		phandle = <0x1c2>;
	};

	vdd_1v8_s3: vdd-1v8-s3 {
		compatible = "regulator-fixed";
		regulator-name = "vdd_1v8_s3";
		regulator-always-on;
		regulator-boot-on;
		regulator-min-microvolt = <0x1b7740>;
		regulator-max-microvolt = <0x1b7740>;
		vin-supply = <&vcc5v0_sys>;
		phandle = <0x5a>;
	};

	vcc_3v3_s3: vcc-3v3-s3 {
		compatible = "regulator-fixed";
		regulator-name = "vcc_3v3_s3";
		regulator-always-on;
		regulator-boot-on;
		regulator-min-microvolt = <0x325aa0>;
		regulator-max-microvolt = <0x325aa0>;
		vin-supply = <&vcc5v0_sys>;
		phandle = <0xa3>;
	};

	vcc_sd: vcc-sd {
		compatible = "regulator-fixed";
		gpio = <&gpio4 0x01 0x01>;
		regulator-name = "vcc_sd";
		regulator-min-microvolt = <0x325aa0>;
		regulator-max-microvolt = <0x325aa0>;
		vin-supply = <&vcc_3v3_s3>;
		phandle = <0x82>;
	};

	vcc_ddr_s3: vcc-ddr-s3 {
		compatible = "regulator-fixed";
		regulator-name = "vcc_ddr_s3";
		regulator-always-on;
		regulator-boot-on;
		regulator-min-microvolt = <0x124f80>;
		regulator-max-microvolt = <0x124f80>;
		vin-supply = <&vcc5v0_sys>;
		phandle = <0x1c3>;
	};

	sdio_pwrseq: sdio-pwrseq {
		compatible = "mmc-pwrseq-simple";
		pinctrl-names = "default";
		pinctrl-0 = <&wifi_enable_h &clkm1_32k_out>;
		post-power-on-delay-ms = <0xc8>;
		reset-gpios = <&gpio3 0x0a 0x01>;
		status = "okay";
		phandle = <0x79>;
	};

	wireless_bluetooth: wireless-bluetooth {
		compatible = "bluetooth-platdata";
		uart_rts_gpios = <&gpio1 0x0a 0x01>;
		pinctrl-names = "default", "rts_gpio";
		pinctrl-0 = <&uart2m1_rtsn>;
		pinctrl-1 = <&uart2m1_gpios>;
		BT,reset_gpio = <&gpio1 0x11 0x00>;
		BT,wake_gpio = <&gpio1 0x0c 0x00>;
		BT,wake_host_irq = <0xa7 0x12 0x00>;
		status = "disabled";
		phandle = <0x1c4>;
	};

	wireless_wlan: wireless-wlan {
		compatible = "wlan-platdata";
		rockchip,grf = <&grf>;
		wifi_chip_type = "ap6275s";
		pinctrl-names = "default";
		pinctrl-0 = <&wifi_host_wake_irq>;
		WIFI,host_wake_irq = <0xa7 0x07 0x00>;
		status = "disabled";
		phandle = <0x1c5>;
	};

	seekwcn_boot: seekwcn_boot {
		compatible = "seekwave,sv6160lite";
		dma_type = <0x01>;
		seekwave_nv_name = "SEEKWAVE_NV_SWT6652.bin";
		status = "okay";
		gpio_host_wake = <0xa6 0x0b 0x01>;
		gpio_chip_wake = <0xa6 0x0c 0x00>;
		gpio_chip_en = <0xa6 0x0a 0x00>;
		phandle = <0x1c6>;
	};

	leds: gpio-leds {
		compatible = "gpio-leds";
		phandle = <0x1c7>;

		/* power/standby are the names the shared LED hooks drive; the factory called
		 * them work-green and work-red */
		power {
			gpios = <&gpio4 0x11 0x01>;
			linux,default-trigger = "none";
			default-state = "on";
			retain-state-suspended;
			retain-state-shutdown;
		};

		/* the standby half of the same rename; the factory called it work-red */
		standby {
			gpios = <&gpio4 0x0b 0x01>;
			linux,default-trigger = "none";
			default-state = "off";
			retain-state-suspended;
			retain-state-shutdown;
		};
	};

	/* chosen dropped: u-boot supplies bootargs, and the vendor string names ttyFIQ0 */

	fiq-debugger {
		compatible = "rockchip,fiq-debugger";
		rockchip,serial-id = <0x00>;
		rockchip,wake-irq = <0x00>;
		rockchip,irq-mode-enable = <0x01>;
		rockchip,baudrate = <0x16e360>;
		interrupts = <0x00 0xba 0x04>;
		pinctrl-names = "default";
		pinctrl-0 = <&uart0m0_xfer>;
		/* frees ff9f0000 for ttyS0 above */
		status = "disabled";
	};

	reserved_memory: reserved-memory {
		#address-cells = <0x02>;
		#size-cells = <0x02>;
		ranges;
		phandle = <0x1c9>;

		cma {
			compatible = "shared-dma-pool";
			reusable;
			size = <0x00 0x800000>;
			linux,cma-default;
		};

		drm_logo: drm-logo@0 {
			compatible = "rockchip,drm-logo";
			reg = <0x00 0x00 0x00 0x00>;
			phandle = <0x15>;
		};

		drm_cubic_lut: drm-cubic-lut@0 {
			compatible = "rockchip,drm-cubic-lut";
			reg = <0x00 0x00 0x00 0x00>;
			phandle = <0x16>;
		};

		ramoops: ramoops@110000 {
			compatible = "ramoops";
			reg = <0x00 0x110000 0x00 0xe0000>;
			boot-log-size = <0x8000>;
			boot-log-count = <0x01>;
			console-size = <0x80000>;
			pmsg-size = <0x30000>;
			ftrace-size = <0x00>;
			record-size = <0x14000>;
			phandle = <0x1ca>;
		};
	};
};
